// SPDX-License-Identifier: (GPL-2.0+ OR MIT)
/*
 * Keep the phandle values of the 2026-10-11 pre-overlay Linux DTB.
 * All hardware references in the board files use labels. These explicit
 * assignments preserve the byte-level reference map and existing overlay
 * compatibility when includes are reorganized; they are not GPIO numbers.
 * Do not renumber these handles when editing board hardware parameters.
 */
&gic { phandle = <0x1>; };
&scmi_clk { phandle = <0x2>; };
&cpu0_opp_table { phandle = <0x3>; };
&CPU_SLEEP { phandle = <0x4>; };
&vdd_cpu { phandle = <0x5>; };
&cpu_leakage { phandle = <0x6>; };
&core_pvtm { phandle = <0x7>; };
&mbist_vmin { phandle = <0x8>; };
&cpu_opp_info { phandle = <0x9>; };
&specification_serial_number { phandle = <0xa>; };
&remark_spec_serial_number { phandle = <0xb>; };
&cpu0 { phandle = <0xc>; };
&cpu1 { phandle = <0xd>; };
&cpu2 { phandle = <0xe>; };
&cpu3 { phandle = <0xf>; };
&otp_id { phandle = <0x10>; };
&otp_cpu_version { phandle = <0x11>; };
&cpu_code { phandle = <0x12>; };
&drm_logo { phandle = <0x13>; };
&drm_cubic_lut { phandle = <0x14>; };
&vop_out { phandle = <0x15>; };
&dmc { phandle = <0x16>; };
&vp0_out_dsi0 { phandle = <0x17>; };
&vp0_out_dsi1 { phandle = <0x18>; };
&vp0_out_edp { phandle = <0x19>; };
&vp1_out_hdmi { phandle = <0x1a>; };
&vp1_out_lvds { phandle = <0x1b>; };
&vp2_out_rgb { phandle = <0x1c>; };
&scmi_shmem { phandle = <0x1d>; };
&mipi_csi2_hw { phandle = <0x1e>; };
&tsadc { phandle = <0x1f>; };
&target { phandle = <0x20>; };
&gpu { phandle = <0x21>; };
&clk32k_out0 { phandle = <0x22>; };
&cru { phandle = <0x23>; };
&combphy0_us { phandle = <0x24>; };
&power { phandle = <0x25>; };
&combphy1_usq { phandle = <0x26>; };
&combphy2_psq { phandle = <0x27>; };
&u2phy0_otg { phandle = <0x28>; };
&u2phy0_host { phandle = <0x29>; };
&usb2phy1 { phandle = <0x2a>; };
&u2phy1_otg { phandle = <0x2b>; };
&u2phy1_host { phandle = <0x2c>; };
&vcc3v3_pmu { phandle = <0x2d>; };
&vccio_acodec { phandle = <0x2e>; };
&vccio_sd { phandle = <0x2f>; };
&vcc_1v8 { phandle = <0x30>; };
&vcc_3v3 { phandle = <0x31>; };
&video_phy0 { phandle = <0x32>; };
&vp2_out_lvds { phandle = <0x33>; };
&video_phy1 { phandle = <0x34>; };
&vp1_out_lvds1 { phandle = <0x35>; };
&vp2_out_lvds1 { phandle = <0x36>; };
&lcdc_ctl { phandle = <0x37>; };
&pmucru { phandle = <0x38>; };
&grf { phandle = <0x39>; };
&pmugrf { phandle = <0x3a>; };
&i2c0_xfer { phandle = <0x3b>; };
&vcc5v0_sys { phandle = <0x3c>; };
&gpio0 { phandle = <0x3d>; };
&pmic_int { phandle = <0x3e>; };
&soc_slppin_slp { phandle = <0x3f>; };
&rk817_slppin_slp { phandle = <0x40>; };
&soc_slppin_gpio { phandle = <0x41>; };
&rk817_slppin_pwrdn { phandle = <0x42>; };
&rk817_slppin_rst { phandle = <0x43>; };
&vcc3v3_sys { phandle = <0x44>; };
&dmac0 { phandle = <0x45>; };
&uart0_xfer { phandle = <0x46>; };
&pwm0m0_pins { phandle = <0x47>; };
&pwm1m0_pins { phandle = <0x48>; };
&pwm2m0_pins { phandle = <0x49>; };
&pwm3_pins { phandle = <0x4a>; };
&qos_npu { phandle = <0x4b>; };
&qos_gpu { phandle = <0x4c>; };
&qos_isp { phandle = <0x4d>; };
&qos_vicap0 { phandle = <0x4e>; };
&qos_vicap1 { phandle = <0x4f>; };
&qos_hdcp { phandle = <0x50>; };
&qos_vop_m0 { phandle = <0x51>; };
&qos_vop_m1 { phandle = <0x52>; };
&qos_ebc { phandle = <0x53>; };
&qos_iep { phandle = <0x54>; };
&qos_jpeg_dec { phandle = <0x55>; };
&qos_jpeg_enc { phandle = <0x56>; };
&qos_rga_rd { phandle = <0x57>; };
&qos_rga_wr { phandle = <0x58>; };
&qos_vpu { phandle = <0x59>; };
&qos_rkvdec { phandle = <0x5a>; };
&qos_rkvenc_rd_m0 { phandle = <0x5b>; };
&qos_rkvenc_rd_m1 { phandle = <0x5c>; };
&qos_rkvenc_wr_m0 { phandle = <0x5d>; };
&qos_pcie2x1 { phandle = <0x5e>; };
&qos_pcie3x1 { phandle = <0x5f>; };
&qos_pcie3x2 { phandle = <0x60>; };
&qos_sata0 { phandle = <0x61>; };
&qos_sata1 { phandle = <0x62>; };
&qos_sata2 { phandle = <0x63>; };
&qos_usb3_0 { phandle = <0x64>; };
&qos_usb3_1 { phandle = <0x65>; };
&npu_opp_table { phandle = <0x66>; };
&rknpu_mmu { phandle = <0x67>; };
&npu_leakage { phandle = <0x68>; };
&npu_opp_info { phandle = <0x69>; };
&bus_npu_opp_table { phandle = <0x6a>; };
&gpu_opp_table { phandle = <0x6b>; };
&gpu_leakage { phandle = <0x6c>; };
&gpu_opp_info { phandle = <0x6d>; };
&vdpu_mmu { phandle = <0x6e>; };
&mpp_srv { phandle = <0x6f>; };
&ebc_pins { phandle = <0x70>; };
&jpegd_mmu { phandle = <0x71>; };
&vepu_mmu { phandle = <0x72>; };
&iep_mmu { phandle = <0x73>; };
&rkvenc_mmu { phandle = <0x74>; };
&rkvenc_opp_table { phandle = <0x75>; };
&rkvdec_opp_table { phandle = <0x76>; };
&vdd_logic { phandle = <0x77>; };
&rkvdec_mmu { phandle = <0x78>; };
&rkvdec_sram { phandle = <0x79>; };
&log_leakage { phandle = <0x7a>; };
&rkcif_mmu { phandle = <0x7b>; };
&rkcif { phandle = <0x7c>; };
&rkcif_dvp { phandle = <0x7d>; };
&rkcif_mipi_lvds { phandle = <0x7e>; };
&rkisp_mmu { phandle = <0x7f>; };
&rkisp { phandle = <0x80>; };
&gmac1 { phandle = <0x81>; };
&gmac1_stmmac_axi_setup { phandle = <0x82>; };
&gmac1_mtl_rx_setup { phandle = <0x83>; };
&gmac1_mtl_tx_setup { phandle = <0x84>; };
&vop_mmu { phandle = <0x85>; };
&dsi0_in_vp0 { phandle = <0x86>; };
&dsi1_in_vp0 { phandle = <0x87>; };
&edp_in_vp0 { phandle = <0x88>; };
&hdmi_in_vp0 { phandle = <0x89>; };
&dsi0_in_vp1 { phandle = <0x8a>; };
&dsi1_in_vp1 { phandle = <0x8b>; };
&edp_in_vp1 { phandle = <0x8c>; };
&hdmi_in_vp1 { phandle = <0x8d>; };
&lvds_in_vp1 { phandle = <0x8e>; };
&lvds1_in_vp1 { phandle = <0x8f>; };
&lvds_in_vp2 { phandle = <0x90>; };
&rgb_in_vp2 { phandle = <0x91>; };
&lvds1_in_vp2 { phandle = <0x92>; };
&vp1_out_dsi0 { phandle = <0x93>; };
&vp1_out_dsi1 { phandle = <0x94>; };
&hdmitx_scl { phandle = <0x95>; };
&hdmitx_sda { phandle = <0x96>; };
&hdmitxm0_cec { phandle = <0x97>; };
&vp0_out_hdmi { phandle = <0x98>; };
&edp_phy { phandle = <0x99>; };
&vp1_out_edp { phandle = <0x9a>; };
&dfi { phandle = <0x9b>; };
&nocp_cpu { phandle = <0x9c>; };
&dmc_opp_table { phandle = <0x9d>; };
&ddr3_params { phandle = <0x9e>; };
&ddr4_params { phandle = <0x9f>; };
&lpddr3_params { phandle = <0xa0>; };
&lpddr4_params { phandle = <0xa1>; };
&lpddr4x_params { phandle = <0xa2>; };
&dmc_opp_info { phandle = <0xa3>; };
&pcie2x1_intc { phandle = <0xa4>; };
&its { phandle = <0xa5>; };
&pcie3x1_intc { phandle = <0xa6>; };
&pcie30phy { phandle = <0xa7>; };
&pcie3x2_intc { phandle = <0xa8>; };
&gmac0 { phandle = <0xa9>; };
&gmac0_stmmac_axi_setup { phandle = <0xaa>; };
&gmac0_mtl_rx_setup { phandle = <0xab>; };
&gmac0_mtl_tx_setup { phandle = <0xac>; };
&sdio_pwrseq { phandle = <0xad>; };
&sdmmc1_bus4 { phandle = <0xae>; };
&sdmmc1_cmd { phandle = <0xaf>; };
&sdmmc1_clk { phandle = <0xb0>; };
&dmac1 { phandle = <0xb1>; };
&i2s1m0_sclktx { phandle = <0xb2>; };
&i2s1m0_sclkrx { phandle = <0xb3>; };
&i2s1m0_lrcktx { phandle = <0xb4>; };
&i2s1m0_lrckrx { phandle = <0xb5>; };
&i2s1m0_sdi0 { phandle = <0xb6>; };
&i2s1m0_sdi1 { phandle = <0xb7>; };
&i2s1m0_sdi2 { phandle = <0xb8>; };
&i2s1m0_sdi3 { phandle = <0xb9>; };
&i2s1m0_sdo0 { phandle = <0xba>; };
&i2s1m0_sdo1 { phandle = <0xbb>; };
&i2s1m0_sdo2 { phandle = <0xbc>; };
&i2s1m0_sdo3 { phandle = <0xbd>; };
&i2s2m0_sclktx { phandle = <0xbe>; };
&i2s2m0_lrcktx { phandle = <0xbf>; };
&i2s2m0_sdi { phandle = <0xc0>; };
&i2s2m0_sdo { phandle = <0xc1>; };
&i2s3m0_sclk { phandle = <0xc2>; };
&i2s3m0_lrck { phandle = <0xc3>; };
&i2s3m0_sdi { phandle = <0xc4>; };
&i2s3m0_sdo { phandle = <0xc5>; };
&pdmm0_clk { phandle = <0xc6>; };
&pdmm0_clk1 { phandle = <0xc7>; };
&pdmm0_sdi0 { phandle = <0xc8>; };
&pdmm0_sdi1 { phandle = <0xc9>; };
&pdmm0_sdi2 { phandle = <0xca>; };
&pdmm0_sdi3 { phandle = <0xcb>; };
&spdifm0_tx { phandle = <0xcc>; };
&acodec_pins { phandle = <0xcd>; };
&scr_pins { phandle = <0xce>; };
&i2c1_xfer { phandle = <0xcf>; };
&i2c2m0_xfer { phandle = <0xd0>; };
&i2c3m0_xfer { phandle = <0xd1>; };
&i2c4m0_xfer { phandle = <0xd2>; };
&i2c5m0_xfer { phandle = <0xd3>; };
&spi0m0_cs0 { phandle = <0xd4>; };
&spi0m0_cs1 { phandle = <0xd5>; };
&spi0m0_pins { phandle = <0xd6>; };
&spi0m0_pins_hs { phandle = <0xd7>; };
&spi1m0_cs0 { phandle = <0xd8>; };
&spi1m0_cs1 { phandle = <0xd9>; };
&spi1m0_pins { phandle = <0xda>; };
&spi1m0_pins_hs { phandle = <0xdb>; };
&spi2m0_cs0 { phandle = <0xdc>; };
&spi2m0_cs1 { phandle = <0xdd>; };
&spi2m0_pins { phandle = <0xde>; };
&spi2m0_pins_hs { phandle = <0xdf>; };
&spi3m0_cs0 { phandle = <0xe0>; };
&spi3m0_cs1 { phandle = <0xe1>; };
&spi3m0_pins { phandle = <0xe2>; };
&spi3m0_pins_hs { phandle = <0xe3>; };
&uart1m0_xfer { phandle = <0xe4>; };
&uart2m0_xfer { phandle = <0xe5>; };
&uart3m0_xfer { phandle = <0xe6>; };
&uart4m0_xfer { phandle = <0xe7>; };
&uart5m0_xfer { phandle = <0xe8>; };
&uart6m0_xfer { phandle = <0xe9>; };
&uart7m0_xfer { phandle = <0xea>; };
&uart8m0_xfer { phandle = <0xeb>; };
&uart9m0_xfer { phandle = <0xec>; };
&pwm4_pins { phandle = <0xed>; };
&pwm5_pins { phandle = <0xee>; };
&pwm6_pins { phandle = <0xef>; };
&pwm7_pins { phandle = <0xf0>; };
&pwm8m0_pins { phandle = <0xf1>; };
&pwm9m0_pins { phandle = <0xf2>; };
&pwm10m0_pins { phandle = <0xf3>; };
&pwm11m0_pins { phandle = <0xf4>; };
&pwm12m0_pins { phandle = <0xf5>; };
&pwm13m0_pins { phandle = <0xf6>; };
&pwm14m0_pins { phandle = <0xf7>; };
&pwm15m0_pins { phandle = <0xf8>; };
&tsadc_trim_base { phandle = <0xf9>; };
&tsadc_trim_base_frac { phandle = <0xfa>; };
&tsadc_gpio_func { phandle = <0xfb>; };
&tsadc_shutorg { phandle = <0xfc>; };
&cpu_tsadc_trim_l { phandle = <0xfd>; };
&cpu_tsadc_trim_h { phandle = <0xfe>; };
&gpu_tsadc_trim_l { phandle = <0xff>; };
&gpu_tsadc_trim_h { phandle = <0x100>; };
&pipegrf { phandle = <0x101>; };
&pipe_phy_grf0 { phandle = <0x102>; };
&pipe_phy_grf1 { phandle = <0x103>; };
&pipe_phy_grf2 { phandle = <0x104>; };
&csi2_dphy_hw { phandle = <0x105>; };
&usb2phy0 { phandle = <0x106>; };
&usb2phy0_grf { phandle = <0x107>; };
&vcc5v0_host { phandle = <0x108>; };
&usb2phy1_grf { phandle = <0x109>; };
&pcie30_phy_grf { phandle = <0x10a>; };
&pcfg_pull_none { phandle = <0x10b>; };
&pcfg_pull_up_drv_level_2 { phandle = <0x10c>; };
&pcfg_pull_up { phandle = <0x10d>; };
&pcfg_pull_none_drv_level_2 { phandle = <0x10e>; };
&pcfg_pull_none_drv_level_1 { phandle = <0x10f>; };
&pcfg_pull_none_smt { phandle = <0x110>; };
&pcfg_output_low_pull_down { phandle = <0x111>; };
&pcfg_pull_up_drv_level_1 { phandle = <0x112>; };
&pcfg_pull_none_drv_level_3 { phandle = <0x113>; };
&dc_12v { phandle = <0x114>; };
&vcc5v0_usb { phandle = <0x115>; };
&rk809 { phandle = <0x116>; };
&wifi_enable { phandle = <0x117>; };
&gpio2 { phandle = <0x118>; };
&wifi_host_wake_irq { phandle = <0x119>; };
&arm_pmu { phandle = <0x11a>; };
&display_subsystem { phandle = <0x11b>; };
&route_dsi0 { phandle = <0x11c>; };
&route_dsi1 { phandle = <0x11d>; };
&route_edp { phandle = <0x11e>; };
&route_hdmi { phandle = <0x11f>; };
&route_lvds { phandle = <0x120>; };
&route_rgb { phandle = <0x121>; };
&edac { phandle = <0x122>; };
&scmi { phandle = <0x123>; };
&sdei { phandle = <0x124>; };
&mipi_csi2 { phandle = <0x125>; };
&reserved_memory { phandle = <0x126>; };
&rockchip_suspend { phandle = <0x127>; };
&rockchip_system_monitor { phandle = <0x128>; };
&thermal_zones { phandle = <0x129>; };
&soc_thermal { phandle = <0x12a>; };
&threshold { phandle = <0x12b>; };
&soc_crit { phandle = <0x12c>; };
&gpu_thermal { phandle = <0x12d>; };
&gmac0_clkin { phandle = <0x12e>; };
&gmac1_clkin { phandle = <0x12f>; };
&gmac0_xpcsclk { phandle = <0x130>; };
&gmac1_xpcsclk { phandle = <0x131>; };
&i2s1_mclkin_rx { phandle = <0x132>; };
&i2s1_mclkin_tx { phandle = <0x133>; };
&i2s2_mclkin { phandle = <0x134>; };
&i2s3_mclkin { phandle = <0x135>; };
&mpll { phandle = <0x136>; };
&xin24m { phandle = <0x137>; };
&xin32k { phandle = <0x138>; };
&sata0 { phandle = <0x139>; };
&sata1 { phandle = <0x13a>; };
&sata2 { phandle = <0x13b>; };
&usbdrd30 { phandle = <0x13c>; };
&usbdrd_dwc3 { phandle = <0x13d>; };
&usbhost30 { phandle = <0x13e>; };
&usbhost_dwc3 { phandle = <0x13f>; };
&usb_host0_ehci { phandle = <0x140>; };
&usb_host0_ohci { phandle = <0x141>; };
&usb_host1_ehci { phandle = <0x142>; };
&usb_host1_ohci { phandle = <0x143>; };
&xpcs { phandle = <0x144>; };
&pmu_io_domains { phandle = <0x145>; };
&reboot_mode { phandle = <0x146>; };
&io_domains { phandle = <0x147>; };
&lvds { phandle = <0x148>; };
&lvds1 { phandle = <0x149>; };
&rgb { phandle = <0x14a>; };
&edp_phy_grf { phandle = <0x14b>; };
&sram { phandle = <0x14c>; };
&i2c0 { phandle = <0x14d>; };
&pinctrl_rk8xx { phandle = <0x14e>; };
&rk817_slppin_null { phandle = <0x14f>; };
&vdd_gpu { phandle = <0x150>; };
&vcc_ddr { phandle = <0x151>; };
&vdd_npu { phandle = <0x152>; };
&vdda0v9_image { phandle = <0x153>; };
&vdda_0v9 { phandle = <0x154>; };
&vdda0v9_pmu { phandle = <0x155>; };
&vcca_1v8 { phandle = <0x156>; };
&vcca1v8_pmu { phandle = <0x157>; };
&vcca1v8_image { phandle = <0x158>; };
&vcc3v3_sd { phandle = <0x159>; };
&uart0 { phandle = <0x15a>; };
&pwm0 { phandle = <0x15b>; };
&pwm1 { phandle = <0x15c>; };
&pwm2 { phandle = <0x15d>; };
&pwm3 { phandle = <0x15e>; };
&pmu { phandle = <0x15f>; };
&rknpu { phandle = <0x160>; };
&bus_npu { phandle = <0x161>; };
&gpu_power_model { phandle = <0x162>; };
&vdpu { phandle = <0x163>; };
&rk_rga { phandle = <0x164>; };
&ebc { phandle = <0x165>; };
&jpegd { phandle = <0x166>; };
&vepu { phandle = <0x167>; };
&iep { phandle = <0x168>; };
&eink { phandle = <0x169>; };
&rkvenc { phandle = <0x16a>; };
&rkvdec { phandle = <0x16b>; };
&rkcif_dvp_sditf { phandle = <0x16c>; };
&rkcif_mipi_lvds_sditf { phandle = <0x16d>; };
&rkisp_vir0 { phandle = <0x16e>; };
&rkisp_vir1 { phandle = <0x16f>; };
&gmac_uio1 { phandle = <0x170>; };
&mdio1 { phandle = <0x171>; };
&vop { phandle = <0x172>; };
&vp0 { phandle = <0x173>; };
&vp1 { phandle = <0x174>; };
&vp2 { phandle = <0x175>; };
&dsi0 { phandle = <0x176>; };
&dsi0_in { phandle = <0x177>; };
&dsi1 { phandle = <0x178>; };
&dsi1_in { phandle = <0x179>; };
&hdmi { phandle = <0x17a>; };
&edp { phandle = <0x17b>; };
&edp_in { phandle = <0x17c>; };
&nocp_gpu_vpu_rga_venc { phandle = <0x17d>; };
&nocp_npu_vdec { phandle = <0x17e>; };
&nocp_vi_usb_peri_pipe { phandle = <0x17f>; };
&nocp_vo { phandle = <0x180>; };
&sdmmc2 { phandle = <0x181>; };
&dmc_fsp { phandle = <0x182>; };
&pcie2x1 { phandle = <0x183>; };
&pcie3x1 { phandle = <0x184>; };
&pcie3x2 { phandle = <0x185>; };
&gmac_uio0 { phandle = <0x186>; };
&mdio0 { phandle = <0x187>; };
&sdmmc0 { phandle = <0x188>; };
&sdmmc1 { phandle = <0x189>; };
&sfc { phandle = <0x18a>; };
&sdhci { phandle = <0x18b>; };
&nandc0 { phandle = <0x18c>; };
&crypto { phandle = <0x18d>; };
&rng { phandle = <0x18e>; };
&otp { phandle = <0x18f>; };
&i2s0_8ch { phandle = <0x190>; };
&i2s1_8ch { phandle = <0x191>; };
&i2s2_2ch { phandle = <0x192>; };
&i2s3_2ch { phandle = <0x193>; };
&pdm { phandle = <0x194>; };
&vad { phandle = <0x195>; };
&spdif_8ch { phandle = <0x196>; };
&audpwm { phandle = <0x197>; };
&dig_acodec { phandle = <0x198>; };
&scr { phandle = <0x199>; };
&can0 { phandle = <0x19a>; };
&can1 { phandle = <0x19b>; };
&can2 { phandle = <0x19c>; };
&i2c1 { phandle = <0x19d>; };
&i2c2 { phandle = <0x19e>; };
&i2c3 { phandle = <0x19f>; };
&i2c4 { phandle = <0x1a0>; };
&i2c5 { phandle = <0x1a1>; };
&rktimer { phandle = <0x1a2>; };
&wdt { phandle = <0x1a3>; };
&spi0 { phandle = <0x1a4>; };
&spi1 { phandle = <0x1a5>; };
&spi2 { phandle = <0x1a6>; };
&spi3 { phandle = <0x1a7>; };
&uart1 { phandle = <0x1a8>; };
&uart2 { phandle = <0x1a9>; };
&uart3 { phandle = <0x1aa>; };
&uart4 { phandle = <0x1ab>; };
&uart5 { phandle = <0x1ac>; };
&uart6 { phandle = <0x1ad>; };
&uart7 { phandle = <0x1ae>; };
&uart8 { phandle = <0x1af>; };
&uart9 { phandle = <0x1b0>; };
&pwm4 { phandle = <0x1b1>; };
&pwm5 { phandle = <0x1b2>; };
&pwm6 { phandle = <0x1b3>; };
&pwm7 { phandle = <0x1b4>; };
&pwm8 { phandle = <0x1b5>; };
&pwm9 { phandle = <0x1b6>; };
&pwm10 { phandle = <0x1b7>; };
&pwm11 { phandle = <0x1b8>; };
&pwm12 { phandle = <0x1b9>; };
&pwm13 { phandle = <0x1ba>; };
&pwm14 { phandle = <0x1bb>; };
&pwm15 { phandle = <0x1bc>; };
&saradc { phandle = <0x1bd>; };
&mailbox { phandle = <0x1be>; };
&csi2_dphy0 { phandle = <0x1bf>; };
&csi2_dphy1 { phandle = <0x1c0>; };
&csi2_dphy2 { phandle = <0x1c1>; };
&pinctrl { phandle = <0x1c2>; };
&gpio1 { phandle = <0x1c3>; };
&gpio3 { phandle = <0x1c4>; };
&gpio4 { phandle = <0x1c5>; };
&pcfg_pull_down { phandle = <0x1c6>; };
&pcfg_pull_none_drv_level_0 { phandle = <0x1c7>; };
&pcfg_pull_none_drv_level_4 { phandle = <0x1c8>; };
&pcfg_pull_none_drv_level_5 { phandle = <0x1c9>; };
&pcfg_pull_none_drv_level_6 { phandle = <0x1ca>; };
&pcfg_pull_none_drv_level_7 { phandle = <0x1cb>; };
&pcfg_pull_none_drv_level_8 { phandle = <0x1cc>; };
&pcfg_pull_none_drv_level_9 { phandle = <0x1cd>; };
&pcfg_pull_none_drv_level_10 { phandle = <0x1ce>; };
&pcfg_pull_none_drv_level_11 { phandle = <0x1cf>; };
&pcfg_pull_none_drv_level_12 { phandle = <0x1d0>; };
&pcfg_pull_none_drv_level_13 { phandle = <0x1d1>; };
&pcfg_pull_none_drv_level_14 { phandle = <0x1d2>; };
&pcfg_pull_none_drv_level_15 { phandle = <0x1d3>; };
&pcfg_pull_up_drv_level_0 { phandle = <0x1d4>; };
&pcfg_pull_up_drv_level_3 { phandle = <0x1d5>; };
&pcfg_pull_up_drv_level_4 { phandle = <0x1d6>; };
&pcfg_pull_up_drv_level_5 { phandle = <0x1d7>; };
&pcfg_pull_up_drv_level_6 { phandle = <0x1d8>; };
&pcfg_pull_up_drv_level_7 { phandle = <0x1d9>; };
&pcfg_pull_up_drv_level_8 { phandle = <0x1da>; };
&pcfg_pull_up_drv_level_9 { phandle = <0x1db>; };
&pcfg_pull_up_drv_level_10 { phandle = <0x1dc>; };
&pcfg_pull_up_drv_level_11 { phandle = <0x1dd>; };
&pcfg_pull_up_drv_level_12 { phandle = <0x1de>; };
&pcfg_pull_up_drv_level_13 { phandle = <0x1df>; };
&pcfg_pull_up_drv_level_14 { phandle = <0x1e0>; };
&pcfg_pull_up_drv_level_15 { phandle = <0x1e1>; };
&pcfg_pull_down_drv_level_0 { phandle = <0x1e2>; };
&pcfg_pull_down_drv_level_1 { phandle = <0x1e3>; };
&pcfg_pull_down_drv_level_2 { phandle = <0x1e4>; };
&pcfg_pull_down_drv_level_3 { phandle = <0x1e5>; };
&pcfg_pull_down_drv_level_4 { phandle = <0x1e6>; };
&pcfg_pull_down_drv_level_5 { phandle = <0x1e7>; };
&pcfg_pull_down_drv_level_6 { phandle = <0x1e8>; };
&pcfg_pull_down_drv_level_7 { phandle = <0x1e9>; };
&pcfg_pull_down_drv_level_8 { phandle = <0x1ea>; };
&pcfg_pull_down_drv_level_9 { phandle = <0x1eb>; };
&pcfg_pull_down_drv_level_10 { phandle = <0x1ec>; };
&pcfg_pull_down_drv_level_11 { phandle = <0x1ed>; };
&pcfg_pull_down_drv_level_12 { phandle = <0x1ee>; };
&pcfg_pull_down_drv_level_13 { phandle = <0x1ef>; };
&pcfg_pull_down_drv_level_14 { phandle = <0x1f0>; };
&pcfg_pull_down_drv_level_15 { phandle = <0x1f1>; };
&pcfg_pull_up_smt { phandle = <0x1f2>; };
&pcfg_pull_down_smt { phandle = <0x1f3>; };
&pcfg_pull_none_drv_level_0_smt { phandle = <0x1f4>; };
&pcfg_pull_none_drv_level_1_smt { phandle = <0x1f5>; };
&pcfg_pull_none_drv_level_2_smt { phandle = <0x1f6>; };
&pcfg_pull_none_drv_level_3_smt { phandle = <0x1f7>; };
&pcfg_pull_none_drv_level_4_smt { phandle = <0x1f8>; };
&pcfg_pull_none_drv_level_5_smt { phandle = <0x1f9>; };
&pcfg_output_high { phandle = <0x1fa>; };
&pcfg_output_high_pull_up { phandle = <0x1fb>; };
&pcfg_output_high_pull_down { phandle = <0x1fc>; };
&pcfg_output_high_pull_none { phandle = <0x1fd>; };
&pcfg_output_low { phandle = <0x1fe>; };
&pcfg_output_low_pull_up { phandle = <0x1ff>; };
&pcfg_output_low_pull_none { phandle = <0x200>; };
&audiopwm_lout { phandle = <0x201>; };
&audiopwm_loutn { phandle = <0x202>; };
&audiopwm_loutp { phandle = <0x203>; };
&audiopwm_rout { phandle = <0x204>; };
&audiopwm_routn { phandle = <0x205>; };
&audiopwm_routp { phandle = <0x206>; };
&bt656m0_pins { phandle = <0x207>; };
&bt656m1_pins { phandle = <0x208>; };
&bt1120_pins { phandle = <0x209>; };
&cam_clkout0 { phandle = <0x20a>; };
&cam_clkout1 { phandle = <0x20b>; };
&can0m0_pins { phandle = <0x20c>; };
&can0m1_pins { phandle = <0x20d>; };
&can1m0_pins { phandle = <0x20e>; };
&can1m1_pins { phandle = <0x20f>; };
&can2m0_pins { phandle = <0x210>; };
&can2m1_pins { phandle = <0x211>; };
&cif_clk { phandle = <0x212>; };
&cif_dvp_clk { phandle = <0x213>; };
&cif_dvp_bus16 { phandle = <0x214>; };
&cif_dvp_bus8 { phandle = <0x215>; };
&clk32k_in { phandle = <0x216>; };
&clk32k_out1 { phandle = <0x217>; };
&cpu_pins { phandle = <0x218>; };
&ebc_extern { phandle = <0x219>; };
&edpdpm0_pins { phandle = <0x21a>; };
&edpdpm1_pins { phandle = <0x21b>; };
&emmc_rstnout { phandle = <0x21c>; };
&emmc_bus8 { phandle = <0x21d>; };
&emmc_clk { phandle = <0x21e>; };
&emmc_cmd { phandle = <0x21f>; };
&emmc_datastrobe { phandle = <0x220>; };
&eth0_pins { phandle = <0x221>; };
&eth1m0_pins { phandle = <0x222>; };
&eth1m1_pins { phandle = <0x223>; };
&flash_pins { phandle = <0x224>; };
&fspi_pins { phandle = <0x225>; };
&fspi_cs1 { phandle = <0x226>; };
&gmac0_miim { phandle = <0x227>; };
&gmac0_clkinout { phandle = <0x228>; };
&gmac0_rx_er { phandle = <0x229>; };
&gmac0_rx_bus2 { phandle = <0x22a>; };
&gmac0_tx_bus2 { phandle = <0x22b>; };
&gmac0_rgmii_clk { phandle = <0x22c>; };
&gmac0_rgmii_bus { phandle = <0x22d>; };
&gmac1m0_miim { phandle = <0x22e>; };
&gmac1m0_clkinout { phandle = <0x22f>; };
&gmac1m0_rx_er { phandle = <0x230>; };
&gmac1m0_rx_bus2 { phandle = <0x231>; };
&gmac1m0_tx_bus2 { phandle = <0x232>; };
&gmac1m0_rgmii_clk { phandle = <0x233>; };
&gmac1m0_rgmii_bus { phandle = <0x234>; };
&gmac1m1_miim { phandle = <0x235>; };
&gmac1m1_clkinout { phandle = <0x236>; };
&gmac1m1_rx_er { phandle = <0x237>; };
&gmac1m1_rx_bus2 { phandle = <0x238>; };
&gmac1m1_tx_bus2 { phandle = <0x239>; };
&gmac1m1_rgmii_clk { phandle = <0x23a>; };
&gmac1m1_rgmii_bus { phandle = <0x23b>; };
&gpu_pins { phandle = <0x23c>; };
&hdmitxm1_cec { phandle = <0x23d>; };
&i2c2m1_xfer { phandle = <0x23e>; };
&i2c3m1_xfer { phandle = <0x23f>; };
&i2c4m1_xfer { phandle = <0x240>; };
&i2c5m1_xfer { phandle = <0x241>; };
&i2s1m0_mclk { phandle = <0x242>; };
&i2s1m1_lrckrx { phandle = <0x243>; };
&i2s1m1_lrcktx { phandle = <0x244>; };
&i2s1m1_mclk { phandle = <0x245>; };
&i2s1m1_sclkrx { phandle = <0x246>; };
&i2s1m1_sclktx { phandle = <0x247>; };
&i2s1m1_sdi0 { phandle = <0x248>; };
&i2s1m1_sdi1 { phandle = <0x249>; };
&i2s1m1_sdi2 { phandle = <0x24a>; };
&i2s1m1_sdi3 { phandle = <0x24b>; };
&i2s1m1_sdo0 { phandle = <0x24c>; };
&i2s1m1_sdo1 { phandle = <0x24d>; };
&i2s1m1_sdo2 { phandle = <0x24e>; };
&i2s1m1_sdo3 { phandle = <0x24f>; };
&i2s1m2_lrckrx { phandle = <0x250>; };
&i2s1m2_lrcktx { phandle = <0x251>; };
&i2s1m2_mclk { phandle = <0x252>; };
&i2s1m2_sclkrx { phandle = <0x253>; };
&i2s1m2_sclktx { phandle = <0x254>; };
&i2s1m2_sdi0 { phandle = <0x255>; };
&i2s1m2_sdi1 { phandle = <0x256>; };
&i2s1m2_sdi2 { phandle = <0x257>; };
&i2s1m2_sdi3 { phandle = <0x258>; };
&i2s1m2_sdo0 { phandle = <0x259>; };
&i2s1m2_sdo1 { phandle = <0x25a>; };
&i2s1m2_sdo2 { phandle = <0x25b>; };
&i2s1m2_sdo3 { phandle = <0x25c>; };
&i2s2m0_lrckrx { phandle = <0x25d>; };
&i2s2m0_mclk { phandle = <0x25e>; };
&i2s2m0_sclkrx { phandle = <0x25f>; };
&i2s2m1_lrckrx { phandle = <0x260>; };
&i2s2m1_lrcktx { phandle = <0x261>; };
&i2s2m1_mclk { phandle = <0x262>; };
&i2s2m1_sclkrx { phandle = <0x263>; };
&i2s2m1_sclktx { phandle = <0x264>; };
&i2s2m1_sdi { phandle = <0x265>; };
&i2s2m1_sdo { phandle = <0x266>; };
&i2s3m0_mclk { phandle = <0x267>; };
&i2s3m1_lrck { phandle = <0x268>; };
&i2s3m1_mclk { phandle = <0x269>; };
&i2s3m1_sclk { phandle = <0x26a>; };
&i2s3m1_sdi { phandle = <0x26b>; };
&i2s3m1_sdo { phandle = <0x26c>; };
&isp_pins { phandle = <0x26d>; };
&jtag_pins { phandle = <0x26e>; };
&mcu_pins { phandle = <0x26f>; };
&npu_pins { phandle = <0x270>; };
&pcie20m0_pins { phandle = <0x271>; };
&pcie20m1_pins { phandle = <0x272>; };
&pcie20m2_pins { phandle = <0x273>; };
&pcie20_buttonrstn { phandle = <0x274>; };
&pcie30x1m0_pins { phandle = <0x275>; };
&pcie30x1m1_pins { phandle = <0x276>; };
&pcie30x1m2_pins { phandle = <0x277>; };
&pcie30x1_buttonrstn { phandle = <0x278>; };
&pcie30x2m0_pins { phandle = <0x279>; };
&pcie30x2m1_pins { phandle = <0x27a>; };
&pcie30x2m2_pins { phandle = <0x27b>; };
&pcie30x2_buttonrstn { phandle = <0x27c>; };
&pdmm1_clk { phandle = <0x27d>; };
&pdmm1_clk1 { phandle = <0x27e>; };
&pdmm1_sdi0 { phandle = <0x27f>; };
&pdmm1_sdi1 { phandle = <0x280>; };
&pdmm1_sdi2 { phandle = <0x281>; };
&pdmm1_sdi3 { phandle = <0x282>; };
&pdmm2_clk1 { phandle = <0x283>; };
&pdmm2_sdi0 { phandle = <0x284>; };
&pdmm2_sdi1 { phandle = <0x285>; };
&pdmm2_sdi2 { phandle = <0x286>; };
&pdmm2_sdi3 { phandle = <0x287>; };
&pmic_pins { phandle = <0x288>; };
&soc_slppin_rst { phandle = <0x289>; };
&pmu_pins { phandle = <0x28a>; };
&pwm0m1_pins { phandle = <0x28b>; };
&pwm1m1_pins { phandle = <0x28c>; };
&pwm2m1_pins { phandle = <0x28d>; };
&pwm8m1_pins { phandle = <0x28e>; };
&pwm9m1_pins { phandle = <0x28f>; };
&pwm10m1_pins { phandle = <0x290>; };
&pwm11m1_pins { phandle = <0x291>; };
&pwm12m1_pins { phandle = <0x292>; };
&pwm13m1_pins { phandle = <0x293>; };
&pwm14m1_pins { phandle = <0x294>; };
&pwm15m1_pins { phandle = <0x295>; };
&refclk_pins { phandle = <0x296>; };
&sata_pins { phandle = <0x297>; };
&sata0_pins { phandle = <0x298>; };
&sata1_pins { phandle = <0x299>; };
&sata2_pins { phandle = <0x29a>; };
&sdmmc0_bus4 { phandle = <0x29b>; };
&sdmmc0_clk { phandle = <0x29c>; };
&sdmmc0_cmd { phandle = <0x29d>; };
&sdmmc0_det { phandle = <0x29e>; };
&sdmmc0_pwren { phandle = <0x29f>; };
&sdmmc1_det { phandle = <0x2a0>; };
&sdmmc1_pwren { phandle = <0x2a1>; };
&sdmmc2m0_bus4 { phandle = <0x2a2>; };
&sdmmc2m0_clk { phandle = <0x2a3>; };
&sdmmc2m0_cmd { phandle = <0x2a4>; };
&sdmmc2m0_det { phandle = <0x2a5>; };
&sdmmc2m0_pwren { phandle = <0x2a6>; };
&sdmmc2m1_bus4 { phandle = <0x2a7>; };
&sdmmc2m1_clk { phandle = <0x2a8>; };
&sdmmc2m1_cmd { phandle = <0x2a9>; };
&sdmmc2m1_det { phandle = <0x2aa>; };
&sdmmc2m1_pwren { phandle = <0x2ab>; };
&spdifm1_tx { phandle = <0x2ac>; };
&spdifm2_tx { phandle = <0x2ad>; };
&spi0m1_pins { phandle = <0x2ae>; };
&spi0m1_cs0 { phandle = <0x2af>; };
&spi1m1_pins { phandle = <0x2b0>; };
&spi1m1_cs0 { phandle = <0x2b1>; };
&spi2m1_pins { phandle = <0x2b2>; };
&spi2m1_cs0 { phandle = <0x2b3>; };
&spi2m1_cs1 { phandle = <0x2b4>; };
&spi3m1_pins { phandle = <0x2b5>; };
&spi3m1_cs0 { phandle = <0x2b6>; };
&spi3m1_cs1 { phandle = <0x2b7>; };
&tsadcm0_shut { phandle = <0x2b8>; };
&tsadcm1_shut { phandle = <0x2b9>; };
&uart0_ctsn { phandle = <0x2ba>; };
&uart0_rtsn { phandle = <0x2bb>; };
&uart1m0_ctsn { phandle = <0x2bc>; };
&uart1m0_rtsn { phandle = <0x2bd>; };
&uart1m1_xfer { phandle = <0x2be>; };
&uart1m1_ctsn { phandle = <0x2bf>; };
&uart1m1_rtsn { phandle = <0x2c0>; };
&uart2m1_xfer { phandle = <0x2c1>; };
&uart3m0_ctsn { phandle = <0x2c2>; };
&uart3m0_rtsn { phandle = <0x2c3>; };
&uart3m1_xfer { phandle = <0x2c4>; };
&uart4m0_ctsn { phandle = <0x2c5>; };
&uart4m0_rtsn { phandle = <0x2c6>; };
&uart4m1_xfer { phandle = <0x2c7>; };
&uart5m0_ctsn { phandle = <0x2c8>; };
&uart5m0_rtsn { phandle = <0x2c9>; };
&uart5m1_xfer { phandle = <0x2ca>; };
&uart6m0_ctsn { phandle = <0x2cb>; };
&uart6m0_rtsn { phandle = <0x2cc>; };
&uart6m1_xfer { phandle = <0x2cd>; };
&uart7m0_ctsn { phandle = <0x2ce>; };
&uart7m0_rtsn { phandle = <0x2cf>; };
&uart7m1_xfer { phandle = <0x2d0>; };
&uart7m2_xfer { phandle = <0x2d1>; };
&uart8m0_ctsn { phandle = <0x2d2>; };
&uart8m0_rtsn { phandle = <0x2d3>; };
&uart8m1_xfer { phandle = <0x2d4>; };
&uart9m0_ctsn { phandle = <0x2d5>; };
&uart9m0_rtsn { phandle = <0x2d6>; };
&uart9m1_xfer { phandle = <0x2d7>; };
&uart9m2_xfer { phandle = <0x2d8>; };
&vopm0_pins { phandle = <0x2d9>; };
&vopm1_pins { phandle = <0x2da>; };
&spi0m0_cs0_hs { phandle = <0x2db>; };
&spi0m0_cs1_hs { phandle = <0x2dc>; };
&spi0m1_pins_hs { phandle = <0x2dd>; };
&spi0m1_cs0_hs { phandle = <0x2de>; };
&spi1m0_cs0_hs { phandle = <0x2df>; };
&spi1m0_cs1_hs { phandle = <0x2e0>; };
&spi1m1_pins_hs { phandle = <0x2e1>; };
&spi1m1_cs0_hs { phandle = <0x2e2>; };
&spi2m0_cs0_hs { phandle = <0x2e3>; };
&spi2m0_cs1_hs { phandle = <0x2e4>; };
&spi2m1_pins_hs { phandle = <0x2e5>; };
&spi2m1_cs0_hs { phandle = <0x2e6>; };
&spi2m1_cs1_hs { phandle = <0x2e7>; };
&spi3m0_cs0_hs { phandle = <0x2e8>; };
&spi3m0_cs1_hs { phandle = <0x2e9>; };
&spi3m1_pins_hs { phandle = <0x2ea>; };
&spi3m1_cs0_hs { phandle = <0x2eb>; };
&spi3m1_cs1_hs { phandle = <0x2ec>; };
&gmac0_tx_bus2_level3 { phandle = <0x2ed>; };
&gmac0_rgmii_bus_level3 { phandle = <0x2ee>; };
&gmac1m0_tx_bus2_level3 { phandle = <0x2ef>; };
&gmac1m0_rgmii_bus_level3 { phandle = <0x2f0>; };
&gmac1m1_tx_bus2_level3 { phandle = <0x2f1>; };
&gmac1m1_rgmii_bus_level3 { phandle = <0x2f2>; };
&gmac0_rgmii_clk_level2 { phandle = <0x2f3>; };
&gmac1m0_rgmii_clk_level2 { phandle = <0x2f4>; };
&gmac1m1_rgmii_clk_level2 { phandle = <0x2f5>; };
&vcc2v5_sys { phandle = <0x2f6>; };
&fiq_debugger { phandle = <0x2f7>; };
&wireless_wlan { phandle = <0x2f8>; };
&rk809_codec { phandle = <0x2f9>; };
&chosen { phandle = <0x2fa>; };
&backlight { phandle = <0x2fb>; };
&dsi0_panel { phandle = <0x2fc>; };
&dsi0_timing { phandle = <0x2fd>; };
&panel_in_dsi { phandle = <0x2fe>; };
&dsi0_out { phandle = <0x2ff>; };
&vcc3v3_lcd0_n { phandle = <0x300>; };
