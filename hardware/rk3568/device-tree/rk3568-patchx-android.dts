/*
 * PatchX 3568A: readable hardware reference for Android 11 / Linux 4.19.232.
 * Reconstructed using original exported symbols; see README.md for provenance.
 * Hardware values are unchanged from the sanitized reference.
 */
/dts-v1/;

/include/ "rk3568-android-base.dtsi"
/include/ "rk3568-android-pinctrl.dtsi"

/ {
	compatible = "rockchip,rk3568-evb1-ddr4-v10", "rockchip,rk3568";
	model = "3568A";
};

/* Read and edit board-level hardware descriptions here. */
/include/ "board/power.dtsi"
/include/ "board/display.dtsi"
/include/ "board/panel-init.dtsi"
/include/ "board/audio.dtsi"
/include/ "board/connectivity.dtsi"

/* Preserve reference handles and exported symbol paths. */
/include/ "rk3568-android-compat.dtsi"
