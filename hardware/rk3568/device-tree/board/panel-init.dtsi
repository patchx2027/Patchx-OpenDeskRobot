/* Original panel commands, grouped as: type, delay (ms), payload length, payload. */
/* Consult the matching panel datasheet before changing any payload. */
&dsi0_panel {
	panel-init-sequence = [
		13 02 02 ff 30
		13 02 02 ff 52
		13 02 02 ff 01
		13 02 02 e3 04
		13 02 02 08 0e
		13 02 02 25 0f
		13 02 02 28 5f
		13 02 02 29 c2
		13 02 02 2a cf
		13 02 02 37 5c
		13 02 02 38 67
		13 02 02 39 5d
		13 02 02 44 00
		13 02 02 49 3c
		13 02 02 59 fe
		13 02 02 5c 00
		13 02 02 80 20
		13 02 02 91 77
		13 02 02 92 77
		13 02 02 98 ca
		13 02 02 99 51
		13 02 02 9a c1
		13 02 02 9b 59
		13 02 02 a0 55
		13 02 02 a1 50
		13 02 02 a4 9c
		13 02 02 a7 02
		13 02 02 a8 01
		13 02 02 a9 21
		13 02 02 aa fc
		13 02 02 ab 28
		13 02 02 ac 06
		13 02 02 ad 06
		13 02 02 ae 06
		13 02 02 af 03
		13 02 02 b0 08
		13 02 02 b1 26
		13 02 02 b2 28
		13 02 02 b3 28
		13 02 02 b4 33
		13 02 02 b5 08
		13 02 02 b6 26
		13 02 02 b7 08
		13 02 02 b8 26
		13 02 02 f0 00
		13 02 02 f6 c0
		13 02 02 c0 00
		13 02 02 c1 00
		13 02 02 c3 0f
		13 02 02 2c 22
		13 02 02 ff 30
		13 02 02 ff 52
		13 02 02 ff 02
		13 02 02 b1 0c
		13 02 02 d1 02
		13 02 02 b4 3f
		13 02 02 d4 3f
		13 02 02 b2 02
		13 02 02 d2 00
		13 02 02 b3 3c
		13 02 02 d3 32
		13 02 02 b6 02
		13 02 02 d6 00
		13 02 02 b7 31
		13 02 02 d7 27
		13 02 02 c1 0a
		13 02 02 e1 00
		13 02 02 b8 0f
		13 02 02 d8 05
		13 02 02 b9 00
		13 02 02 d9 00
		13 02 02 bd 13
		13 02 02 dd 0d
		13 02 02 bc 11
		13 02 02 dc 09
		13 02 02 bb 10
		13 02 02 db 06
		13 02 02 ba 12
		13 02 02 da 08
		13 02 02 be 16
		13 02 02 de 16
		13 02 02 bf 0c
		13 02 02 df 0c
		13 02 02 c0 13
		13 02 02 e0 13
		13 02 02 b5 3f
		13 02 02 d5 2e
		13 02 02 b0 02
		13 02 02 d0 03
		13 02 02 ff 30
		13 02 02 ff 52
		13 02 02 ff 03
		13 02 02 08 85
		13 02 02 09 86
		13 02 02 0a 83
		13 02 02 0b 84
		13 02 02 20 00
		13 02 02 21 00
		13 02 02 22 00
		13 02 02 23 00
		13 02 02 27 03
		13 02 02 28 22
		13 02 02 29 22
		13 02 02 2a d7
		13 02 02 2b d7
		13 02 02 34 11
		13 02 02 35 01
		13 02 02 36 01
		13 02 02 37 03
		13 02 02 40 81
		13 02 02 41 82
		13 02 02 42 01
		13 02 02 43 80
		13 02 02 44 22
		13 02 02 45 d5
		13 02 02 46 d4
		13 02 02 47 22
		13 02 02 48 d7
		13 02 02 49 d6
		13 02 02 50 85
		13 02 02 51 86
		13 02 02 52 83
		13 02 02 53 84
		13 02 02 54 22
		13 02 02 55 d1
		13 02 02 56 d0
		13 02 02 57 22
		13 02 02 58 d3
		13 02 02 59 d2
		13 02 02 7e 03
		13 02 02 7f 02
		13 02 02 80 0f
		13 02 02 81 0f
		13 02 02 82 0e
		13 02 02 83 0e
		13 02 02 84 02
		13 02 02 85 04
		13 02 02 86 04
		13 02 02 87 05
		13 02 02 88 05
		13 02 02 89 06
		13 02 02 8a 06
		13 02 02 8b 07
		13 02 02 8c 07
		13 02 02 8d 0f
		13 02 02 8e 0f
		13 02 02 8f 0d
		13 02 02 90 0d
		13 02 02 91 0c
		13 02 02 92 0c
		13 02 02 93 00
		13 02 02 94 01
		13 02 02 96 0f
		13 02 02 97 0f
		13 02 02 98 0e
		13 02 02 99 0e
		13 02 02 9a 02
		13 02 02 9b 04
		13 02 02 9c 04
		13 02 02 9d 05
		13 02 02 9e 05
		13 02 02 9f 06
		13 02 02 a0 06
		13 02 02 a1 07
		13 02 02 a2 07
		13 02 02 a3 0f
		13 02 02 a4 0f
		13 02 02 a5 0d
		13 02 02 a6 0d
		13 02 02 a7 0c
		13 02 02 a8 0c
		13 02 02 a9 00
		13 02 02 aa 01
		13 02 02 ff 30
		13 02 02 ff 52
		13 02 02 ff 00
		13 02 02 36 02
		13 02 02 53 2c
		05 78 01 11
		05 78 01 29
	];

	panel-exit-sequence = [
		05 00 01 28
		05 00 01 10
	];
};
