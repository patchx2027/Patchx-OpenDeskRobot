/* Stable handles and exported paths. Do not edit manually. */
/ {
	__symbols__ {
		ddr3_params = "/ddr3-params";
		ddr4_params = "/ddr4-params";
		lpddr3_params = "/lpddr3-params";
		lpddr4_params = "/lpddr4-params";
		lpddr4x_params = "/lpddr4x-params";
		cpu0 = "/cpus/cpu@0";
		cpu1 = "/cpus/cpu@100";
		cpu2 = "/cpus/cpu@200";
		cpu3 = "/cpus/cpu@300";
		CPU_SLEEP = "/cpus/idle-states/cpu-sleep";
		cpu0_opp_table = "/cpu0-opp-table";
		display_subsystem = "/display-subsystem";
		route_dsi0 = "/display-subsystem/route/route-dsi0";
		route_dsi1 = "/display-subsystem/route/route-dsi1";
		route_edp = "/display-subsystem/route/route-edp";
		route_hdmi = "/display-subsystem/route/route-hdmi";
		route_lvds = "/display-subsystem/route/route-lvds";
		route_rgb = "/display-subsystem/route/route-rgb";
		firmware_android = "/firmware/android";
		optee = "/firmware/optee";
		scmi = "/firmware/scmi";
		scmi_clk = "/firmware/scmi/protocol@14";
		sdei = "/firmware/sdei";
		mpp_srv = "/mpp-srv";
		reserved_memory = "/reserved-memory";
		drm_logo = "/reserved-memory/drm-logo@00000000";
		drm_cubic_lut = "/reserved-memory/drm-cubic-lut@00000000";
		isp_reserved = "/reserved-memory/isp";
		cif_reserved = "/reserved-memory/cif";
		reserved = "/reserved-memory/buffer@1f0000000";
		ramoops = "/reserved-memory/ramoops@110000";
		rockchip_suspend = "/rockchip-suspend";
		rockchip_system_monitor = "/rockchip-system-monitor";
		thermal_zones = "/thermal-zones";
		soc_thermal = "/thermal-zones/soc-thermal";
		threshold = "/thermal-zones/soc-thermal/trips/trip-point-0";
		target = "/thermal-zones/soc-thermal/trips/trip-point-1";
		soc_crit = "/thermal-zones/soc-thermal/trips/soc-crit";
		gpu_thermal = "/thermal-zones/gpu-thermal";
		gmac0_clkin = "/external-gmac0-clock";
		gmac1_clkin = "/external-gmac1-clock";
		gmac0_xpcsclk = "/xpcs-gmac0-clock";
		gmac1_xpcsclk = "/xpcs-gmac1-clock";
		i2s1_mclkin_rx = "/i2s1-mclkin-rx";
		i2s1_mclkin_tx = "/i2s1-mclkin-tx";
		i2s2_mclkin = "/i2s2-mclkin";
		i2s3_mclkin = "/i2s3-mclkin";
		mpll = "/mpll";
		xin24m = "/xin24m";
		xin32k = "/xin32k";
		scmi_shmem = "/scmi-shmem@10f000";
		sata0 = "/sata@fc000000";
		sata1 = "/sata@fc400000";
		sata2 = "/sata@fc800000";
		usbdrd30 = "/usbdrd";
		usbdrd_dwc3 = "/usbdrd/dwc3@fcc00000";
		usbhost30 = "/usbhost";
		usbhost_dwc3 = "/usbhost/dwc3@fd000000";
		gic = "/interrupt-controller@fd400000";
		its = "/interrupt-controller@fd400000/interrupt-controller@fd440000";
		usb_host0_ehci = "/usb@fd800000";
		usb_host0_ohci = "/usb@fd840000";
		usb_host1_ehci = "/usb@fd880000";
		usb_host1_ohci = "/usb@fd8c0000";
		xpcs = "/syscon@fda00000";
		pmugrf = "/syscon@fdc20000";
		pmu_io_domains = "/syscon@fdc20000/io-domains";
		reboot_mode = "/syscon@fdc20000/reboot-mode";
		pipegrf = "/syscon@fdc50000";
		grf = "/syscon@fdc60000";
		io_domains = "/syscon@fdc60000/io-domains";
		lvds = "/syscon@fdc60000/lvds";
		lvds_in_vp1 = "/syscon@fdc60000/lvds/ports/port@0/endpoint@1";
		lvds_in_vp2 = "/syscon@fdc60000/lvds/ports/port@0/endpoint@2";
		lvds_out_panel = "/syscon@fdc60000/lvds/ports/port@1/endpoint";
		rgb = "/syscon@fdc60000/rgb";
		rgb_in_vp2 = "/syscon@fdc60000/rgb/ports/port@0/endpoint@2";
		pipe_phy_grf0 = "/syscon@fdc70000";
		pipe_phy_grf1 = "/syscon@fdc80000";
		pipe_phy_grf2 = "/syscon@fdc90000";
		usb2phy0_grf = "/syscon@fdca0000";
		usb2phy1_grf = "/syscon@fdca8000";
		edp_phy_grf = "/syscon@fdcb0000";
		edp_phy = "/syscon@fdcb0000/edp-phy";
		pcie30_phy_grf = "/syscon@fdcb8000";
		sram = "/sram@fdcc0000";
		rkvdec_sram = "/sram@fdcc0000/rkvdec-sram@0";
		pmucru = "/clock-controller@fdd00000";
		cru = "/clock-controller@fdd20000";
		i2c0 = "/i2c@fdd40000";
		vdd_cpu = "/i2c@fdd40000/tcs4525@1c";
		rk809 = "/i2c@fdd40000/pmic@20";
		pinctrl_rk8xx = "/i2c@fdd40000/pmic@20/pinctrl_rk8xx";
		rk817_slppin_null = "/i2c@fdd40000/pmic@20/pinctrl_rk8xx/rk817_slppin_null";
		rk817_slppin_slp = "/i2c@fdd40000/pmic@20/pinctrl_rk8xx/rk817_slppin_slp";
		rk817_slppin_pwrdn = "/i2c@fdd40000/pmic@20/pinctrl_rk8xx/rk817_slppin_pwrdn";
		rk817_slppin_rst = "/i2c@fdd40000/pmic@20/pinctrl_rk8xx/rk817_slppin_rst";
		vdd_logic = "/i2c@fdd40000/pmic@20/regulators/DCDC_REG1";
		vdd_gpu = "/i2c@fdd40000/pmic@20/regulators/DCDC_REG2";
		vcc_ddr = "/i2c@fdd40000/pmic@20/regulators/DCDC_REG3";
		vdd_npu = "/i2c@fdd40000/pmic@20/regulators/DCDC_REG4";
		vdda0v9_image = "/i2c@fdd40000/pmic@20/regulators/LDO_REG1";
		vdda_0v9 = "/i2c@fdd40000/pmic@20/regulators/LDO_REG2";
		vdda0v9_pmu = "/i2c@fdd40000/pmic@20/regulators/LDO_REG3";
		vccio_acodec = "/i2c@fdd40000/pmic@20/regulators/LDO_REG4";
		vccio_sd = "/i2c@fdd40000/pmic@20/regulators/LDO_REG5";
		vcc3v3_pmu = "/i2c@fdd40000/pmic@20/regulators/LDO_REG6";
		vcca_1v8 = "/i2c@fdd40000/pmic@20/regulators/LDO_REG7";
		vcca1v8_pmu = "/i2c@fdd40000/pmic@20/regulators/LDO_REG8";
		vcca1v8_image = "/i2c@fdd40000/pmic@20/regulators/LDO_REG9";
		vcc_1v8 = "/i2c@fdd40000/pmic@20/regulators/DCDC_REG5";
		vcc_3v3 = "/i2c@fdd40000/pmic@20/regulators/SWITCH_REG1";
		vcc3v3_sd = "/i2c@fdd40000/pmic@20/regulators/SWITCH_REG2";
		rk809_codec = "/i2c@fdd40000/pmic@20/codec";
		bq25700 = "/i2c@fdd40000/bq25700@6b";
		fusb0 = "/i2c@fdd40000/fusb30x@22";
		uart0 = "/serial@fdd50000";
		pwm0 = "/pwm@fdd70000";
		pwm1 = "/pwm@fdd70010";
		pwm2 = "/pwm@fdd70020";
		pwm3 = "/pwm@fdd70030";
		pmu = "/power-management@fdd90000";
		power = "/power-management@fdd90000/power-controller";
		rknpu = "/npu@fde40000";
		npu_opp_table = "/npu-opp-table";
		bus_npu = "/bus-npu";
		bus_npu_opp_table = "/bus-npu-opp-table";
		rknpu_mmu = "/iommu@fde4b000";
		gpu = "/gpu@fde60000";
		gpu_power_model = "/gpu@fde60000/power-model";
		gpu_opp_table = "/opp-table2";
		vdpu = "/vdpu@fdea0400";
		vdpu_mmu = "/iommu@fdea0800";
		rk_rga = "/rk_rga@fdeb0000";
		ebc = "/ebc@fdec0000";
		jpegd = "/jpegd@fded0000";
		jpegd_mmu = "/iommu@fded0480";
		vepu = "/vepu@fdee0000";
		vepu_mmu = "/iommu@fdee0800";
		iep = "/iep@fdef0000";
		iep_mmu = "/iommu@fdef0800";
		eink = "/eink@fdf00000";
		rkvenc = "/rkvenc@fdf40000";
		rkvenc_opp_table = "/rkvenc-opp-table";
		rkvenc_mmu = "/iommu@fdf40f00";
		rkvdec = "/rkvdec@fdf80200";
		rkvdec_opp_table = "/rkvdec-opp-table";
		rkvdec_mmu = "/iommu@fdf80800";
		mipi_csi2 = "/mipi-csi2@fdfb0000";
		rkcif = "/rkcif@fdfe0000";
		rkcif_mmu = "/iommu@fdfe0800";
		rkcif_dvp = "/rkcif_dvp";
		rkcif_dvp_sditf = "/rkcif_dvp_sditf";
		rkcif_mipi_lvds = "/rkcif_mipi_lvds";
		rkcif_mipi_lvds_sditf = "/rkcif_mipi_lvds_sditf";
		rkisp = "/rkisp@fdff0000";
		rkisp_mmu = "/iommu@fdff1a00";
		rkisp_vir0 = "/rkisp-vir0";
		isp0_in = "/rkisp-vir0/port/endpoint@0";
		rkisp_vir1 = "/rkisp-vir1";
		gmac1 = "/ethernet@fe010000";
		mdio1 = "/ethernet@fe010000/mdio";
		rgmii_phy1 = "/ethernet@fe010000/mdio/phy@0";
		gmac1_stmmac_axi_setup = "/ethernet@fe010000/stmmac-axi-config";
		gmac1_mtl_rx_setup = "/ethernet@fe010000/rx-queues-config";
		gmac1_mtl_tx_setup = "/ethernet@fe010000/tx-queues-config";
		vop = "/vop@fe040000";
		vop_out = "/vop@fe040000/ports";
		vp0 = "/vop@fe040000/ports/port@0";
		vp0_out_dsi0 = "/vop@fe040000/ports/port@0/endpoint@0";
		vp0_out_dsi1 = "/vop@fe040000/ports/port@0/endpoint@1";
		vp0_out_edp = "/vop@fe040000/ports/port@0/endpoint@2";
		vp0_out_hdmi = "/vop@fe040000/ports/port@0/endpoint@3";
		vp1 = "/vop@fe040000/ports/port@1";
		vp1_out_dsi0 = "/vop@fe040000/ports/port@1/endpoint@0";
		vp1_out_dsi1 = "/vop@fe040000/ports/port@1/endpoint@1";
		vp1_out_edp = "/vop@fe040000/ports/port@1/endpoint@2";
		vp1_out_hdmi = "/vop@fe040000/ports/port@1/endpoint@3";
		vp1_out_lvds = "/vop@fe040000/ports/port@1/endpoint@4";
		vp2 = "/vop@fe040000/ports/port@2";
		vp2_out_lvds = "/vop@fe040000/ports/port@2/endpoint@0";
		vp2_out_rgb = "/vop@fe040000/ports/port@2/endpoint@1";
		vop_mmu = "/iommu@fe043e00";
		dsi0 = "/dsi@fe060000";
		dsi0_in = "/dsi@fe060000/ports/port@0";
		dsi0_in_vp0 = "/dsi@fe060000/ports/port@0/endpoint@0";
		dsi0_in_vp1 = "/dsi@fe060000/ports/port@0/endpoint@1";
		dsi_out_panel = "/dsi@fe060000/ports/port@1/endpoint";
		dsi0_panel = "/dsi@fe060000/panel@0";
		dsi0_timing = "/dsi@fe060000/panel@0/display-timings/dsi0_timing";
		dsi0_timing_default = "/dsi@fe060000/panel@0/display-timings/timing_default";
		panel_in_dsi = "/dsi@fe060000/panel@0/ports/port@0/endpoint";
		dsi1 = "/dsi@fe070000";
		dsi1_in = "/dsi@fe070000/ports/port@0";
		dsi1_in_vp0 = "/dsi@fe070000/ports/port@0/endpoint@0";
		dsi1_in_vp1 = "/dsi@fe070000/ports/port@0/endpoint@1";
		dsi1_out_panel = "/dsi@fe070000/ports/port@1/endpoint";
		dsi1_panel = "/dsi@fe070000/panel@0";
		dsi1_timing = "/dsi@fe070000/panel@0/display-timings/dsi1_timing";
		dsi1_timing_default = "/dsi@fe070000/panel@0/display-timings/timing_default";
		panel_in_dsi1 = "/dsi@fe070000/panel@0/ports/port@0/endpoint";
		hdmi = "/hdmi@fe0a0000";
		hdmi_in = "/hdmi@fe0a0000/ports/port@0";
		hdmi_in_vp0 = "/hdmi@fe0a0000/ports/port@0/endpoint@0";
		hdmi_in_vp1 = "/hdmi@fe0a0000/ports/port@0/endpoint@1";
		edp = "/edp@fe0c0000";
		edp_in = "/edp@fe0c0000/ports/port@0";
		edp_in_vp0 = "/edp@fe0c0000/ports/port@0/endpoint@0";
		edp_in_vp1 = "/edp@fe0c0000/ports/port@0/endpoint@1";
		edp_out = "/edp@fe0c0000/ports/port@1/endpoint";
		nocp_cpu = "/nocp-cpu@fe102000";
		nocp_gpu_vpu_rga_venc = "/nocp-gpu-vpu-rga-venc@fe102400";
		nocp_npu_vdec = "/nocp-vdec@fe102800";
		nocp_vi_usb_peri_pipe = "/nocp-vi-usb-peri-pipe@fe102c00";
		nocp_vo = "/nocp-vo@fe103000";
		qos_gpu = "/qos@fe128000";
		qos_rkvenc_rd_m0 = "/qos@fe138080";
		qos_rkvenc_rd_m1 = "/qos@fe138100";
		qos_rkvenc_wr_m0 = "/qos@fe138180";
		qos_isp = "/qos@fe148000";
		qos_vicap0 = "/qos@fe148080";
		qos_vicap1 = "/qos@fe148100";
		qos_vpu = "/qos@fe150000";
		qos_ebc = "/qos@fe158000";
		qos_iep = "/qos@fe158100";
		qos_jpeg_dec = "/qos@fe158180";
		qos_jpeg_enc = "/qos@fe158200";
		qos_rga_rd = "/qos@fe158280";
		qos_rga_wr = "/qos@fe158300";
		qos_npu = "/qos@fe180000";
		qos_pcie2x1 = "/qos@fe190000";
		qos_pcie3x1 = "/qos@fe190080";
		qos_pcie3x2 = "/qos@fe190100";
		qos_sata0 = "/qos@fe190200";
		qos_sata1 = "/qos@fe190280";
		qos_sata2 = "/qos@fe190300";
		qos_usb3_0 = "/qos@fe190380";
		qos_usb3_1 = "/qos@fe190400";
		qos_rkvdec = "/qos@fe198000";
		qos_hdcp = "/qos@fe1a8000";
		qos_vop_m0 = "/qos@fe1a8080";
		qos_vop_m1 = "/qos@fe1a8100";
		sdmmc2 = "/dwmmc@fe000000";
		dfi = "/dfi@fe230000";
		dmc = "/dmc";
		dmc_fsp = "/dmc-fsp";
		dmc_opp_table = "/dmc-opp-table";
		dmcdbg = "/dmcdbg";
		pcie2x1 = "/pcie@fe260000";
		pcie2x1_intc = "/pcie@fe260000/legacy-interrupt-controller";
		pcie3x1 = "/pcie@fe270000";
		pcie3x1_intc = "/pcie@fe270000/legacy-interrupt-controller";
		pcie3x2 = "/pcie@fe280000";
		pcie3x2_intc = "/pcie@fe280000/legacy-interrupt-controller";
		gmac0 = "/ethernet@fe2a0000";
		mdio0 = "/ethernet@fe2a0000/mdio";
		rgmii_phy0 = "/ethernet@fe2a0000/mdio/phy@0";
		gmac0_stmmac_axi_setup = "/ethernet@fe2a0000/stmmac-axi-config";
		gmac0_mtl_rx_setup = "/ethernet@fe2a0000/rx-queues-config";
		gmac0_mtl_tx_setup = "/ethernet@fe2a0000/tx-queues-config";
		sdmmc0 = "/dwmmc@fe2b0000";
		sdmmc1 = "/dwmmc@fe2c0000";
		sfc = "/sfc@fe300000";
		sdhci = "/sdhci@fe310000";
		nandc0 = "/nandc@fe330000";
		crypto = "/crypto@fe380000";
		rng = "/rng@fe388000";
		otp = "/otp@fe38c000";
		cpu_code = "/otp@fe38c000/cpu-code@2";
		otp_cpu_version = "/otp@fe38c000/cpu-version@8";
		mbist_vmin = "/otp@fe38c000/mbist-vmin@9";
		otp_id = "/otp@fe38c000/id@a";
		cpu_leakage = "/otp@fe38c000/cpu-leakage@1a";
		log_leakage = "/otp@fe38c000/log-leakage@1b";
		npu_leakage = "/otp@fe38c000/npu-leakage@1c";
		gpu_leakage = "/otp@fe38c000/gpu-leakage@1d";
		core_pvtm = "/otp@fe38c000/core-pvtm@2a";
		i2s0_8ch = "/i2s@fe400000";
		i2s1_8ch = "/i2s@fe410000";
		i2s2_2ch = "/i2s@fe420000";
		i2s3_2ch = "/i2s@fe430000";
		pdm = "/pdm@fe440000";
		vad = "/vad@fe450000";
		spdif_8ch = "/spdif@fe460000";
		audpwm = "/audpwm@fe470000";
		dig_acodec = "/codec-digital@fe478000";
		dmac0 = "/dmac@fe530000";
		dmac1 = "/dmac@fe550000";
		scr = "/rkscr@fe560000";
		can0 = "/can@fe570000";
		can1 = "/can@fe580000";
		can2 = "/can@fe590000";
		i2c1 = "/i2c@fe5a0000";
		gt1x = "/i2c@fe5a0000/gt1x@14";
		xrm = "/i2c@fe5a0000/xrm117x@30";
		i2c2 = "/i2c@fe5b0000";
		ov13850 = "/i2c@fe5b0000/ov13850@10";
		ov13850_out = "/i2c@fe5b0000/ov13850@10/port/endpoint";
		vm149c = "/i2c@fe5b0000/vm149c@0c";
		ov5695 = "/i2c@fe5b0000/ov5695@36";
		ov5695_out = "/i2c@fe5b0000/ov5695@36/port/endpoint";
		i2c3 = "/i2c@fe5c0000";
		i2c4 = "/i2c@fe5d0000";
		gc8034 = "/i2c@fe5d0000/gc8034@37";
		gc8034_out = "/i2c@fe5d0000/gc8034@37/port/endpoint";
		os04a10 = "/i2c@fe5d0000/os04a10@36";
		ucam_out0 = "/i2c@fe5d0000/os04a10@36/port/endpoint";
		i2c5 = "/i2c@fe5e0000";
		mxc6655xa = "/i2c@fe5e0000/mxc6655xa@15";
		mcu = "/i2c@fe5e0000/mcuinf@62";
		at24c16 = "/i2c@fe5e0000/at24c16@50";
		rktimer = "/timer@fe5f0000";
		wdt = "/watchdog@fe600000";
		spi0 = "/spi@fe610000";
		spi1 = "/spi@fe620000";
		spi2 = "/spi@fe630000";
		spi3 = "/spi@fe640000";
		uart1 = "/serial@fe650000";
		uart2 = "/serial@fe660000";
		uart3 = "/serial@fe670000";
		uart4 = "/serial@fe680000";
		uart5 = "/serial@fe690000";
		uart6 = "/serial@fe6a0000";
		uart7 = "/serial@fe6b0000";
		uart8 = "/serial@fe6c0000";
		uart9 = "/serial@fe6d0000";
		pwm4 = "/pwm@fe6e0000";
		pwm5 = "/pwm@fe6e0010";
		pwm6 = "/pwm@fe6e0020";
		pwm7 = "/pwm@fe6e0030";
		pwm8 = "/pwm@fe6f0000";
		pwm9 = "/pwm@fe6f0010";
		pwm10 = "/pwm@fe6f0020";
		pwm11 = "/pwm@fe6f0030";
		pwm12 = "/pwm@fe700000";
		pwm13 = "/pwm@fe700010";
		pwm14 = "/pwm@fe700020";
		pwm15 = "/pwm@fe700030";
		tsadc = "/tsadc@fe710000";
		saradc = "/saradc@fe720000";
		mailbox = "/mailbox@fe780000";
		combphy0_us = "/phy@fe820000";
		combphy1_usq = "/phy@fe830000";
		combphy2_psq = "/phy@fe840000";
		video_phy0 = "/video-phy@fe850000";
		video_phy1 = "/video-phy@fe860000";
		csi2_dphy_hw = "/csi2-dphy-hw@fe870000";
		csi2_dphy0 = "/csi2-dphy0";
		mipi_in_ucam0 = "/csi2-dphy0/ports/port@0/endpoint@1";
		mipi_in_ucam1 = "/csi2-dphy0/ports/port@0/endpoint@2";
		mipi_in_ucam2 = "/csi2-dphy0/ports/port@0/endpoint@3";
		mipi_in_ucam3 = "/csi2-dphy0/ports/port@0/endpoint@4";
		csidphy_out = "/csi2-dphy0/ports/port@1/endpoint@0";
		csi2_dphy1 = "/csi2-dphy1";
		csi2_dphy2 = "/csi2-dphy2";
		usb2phy0 = "/usb2-phy@fe8a0000";
		u2phy0_host = "/usb2-phy@fe8a0000/host-port";
		u2phy0_otg = "/usb2-phy@fe8a0000/otg-port";
		usb2phy1 = "/usb2-phy@fe8b0000";
		u2phy1_host = "/usb2-phy@fe8b0000/host-port";
		u2phy1_otg = "/usb2-phy@fe8b0000/otg-port";
		pcie30phy = "/phy@fe8c0000";
		pinctrl = "/pinctrl";
		gpio0 = "/pinctrl/gpio@fdd60000";
		gpio1 = "/pinctrl/gpio@fe740000";
		gpio2 = "/pinctrl/gpio@fe750000";
		gpio3 = "/pinctrl/gpio@fe760000";
		gpio4 = "/pinctrl/gpio@fe770000";
		pcfg_pull_up = "/pinctrl/pcfg-pull-up";
		pcfg_pull_none = "/pinctrl/pcfg-pull-none";
		pcfg_pull_none_drv_level_1 = "/pinctrl/pcfg-pull-none-drv-level-1";
		pcfg_pull_none_drv_level_2 = "/pinctrl/pcfg-pull-none-drv-level-2";
		pcfg_pull_none_drv_level_3 = "/pinctrl/pcfg-pull-none-drv-level-3";
		pcfg_pull_up_drv_level_1 = "/pinctrl/pcfg-pull-up-drv-level-1";
		pcfg_pull_up_drv_level_2 = "/pinctrl/pcfg-pull-up-drv-level-2";
		pcfg_pull_none_smt = "/pinctrl/pcfg-pull-none-smt";
		pcfg_output_low_pull_down = "/pinctrl/pcfg-output-low-pull-down";
		acodec_pins = "/pinctrl/acodec/acodec-pins";
		camera_pwr = "/pinctrl/cam/camera-pwr";
		can0m1_pins = "/pinctrl/can0/can0m1-pins";
		can1m1_pins = "/pinctrl/can1/can1m1-pins";
		can2m1_pins = "/pinctrl/can2/can2m1-pins";
		cif_clk = "/pinctrl/cif/cif-clk";
		clk32k_out0 = "/pinctrl/clk32k/clk32k-out0";
		ebc_pins = "/pinctrl/ebc/ebc-pins";
		gmac0_miim = "/pinctrl/gmac0/gmac0-miim";
		gmac0_rx_bus2 = "/pinctrl/gmac0/gmac0-rx-bus2";
		gmac0_tx_bus2 = "/pinctrl/gmac0/gmac0-tx-bus2";
		gmac0_rgmii_clk = "/pinctrl/gmac0/gmac0-rgmii-clk";
		gmac0_rgmii_bus = "/pinctrl/gmac0/gmac0-rgmii-bus";
		gmac1m1_miim = "/pinctrl/gmac1/gmac1m1-miim";
		gmac1m1_rx_bus2 = "/pinctrl/gmac1/gmac1m1-rx-bus2";
		gmac1m1_tx_bus2 = "/pinctrl/gmac1/gmac1m1-tx-bus2";
		gmac1m1_rgmii_clk = "/pinctrl/gmac1/gmac1m1-rgmii-clk";
		gmac1m1_rgmii_bus = "/pinctrl/gmac1/gmac1m1-rgmii-bus";
		hdmitxm0_cec = "/pinctrl/hdmitx/hdmitxm0-cec";
		hdmitx_scl = "/pinctrl/hdmitx/hdmitx-scl";
		hdmitx_sda = "/pinctrl/hdmitx/hdmitx-sda";
		i2c0_xfer = "/pinctrl/i2c0/i2c0-xfer";
		i2c1_xfer = "/pinctrl/i2c1/i2c1-xfer";
		i2c2m1_xfer = "/pinctrl/i2c2/i2c2m1-xfer";
		i2c3m0_xfer = "/pinctrl/i2c3/i2c3m0-xfer";
		i2c4m0_xfer = "/pinctrl/i2c4/i2c4m0-xfer";
		i2c5m0_xfer = "/pinctrl/i2c5/i2c5m0-xfer";
		i2s1m0_lrcktx = "/pinctrl/i2s1/i2s1m0-lrcktx";
		i2s1m0_mclk = "/pinctrl/i2s1/i2s1m0-mclk";
		i2s1m0_sclktx = "/pinctrl/i2s1/i2s1m0-sclktx";
		i2s1m0_sdi0 = "/pinctrl/i2s1/i2s1m0-sdi0";
		i2s1m0_sdo0 = "/pinctrl/i2s1/i2s1m0-sdo0";
		i2s2m0_lrcktx = "/pinctrl/i2s2/i2s2m0-lrcktx";
		i2s2m0_sclktx = "/pinctrl/i2s2/i2s2m0-sclktx";
		i2s2m0_sdi = "/pinctrl/i2s2/i2s2m0-sdi";
		i2s2m0_sdo = "/pinctrl/i2s2/i2s2m0-sdo";
		i2s3m0_lrck = "/pinctrl/i2s3/i2s3m0-lrck";
		i2s3m0_sclk = "/pinctrl/i2s3/i2s3m0-sclk";
		i2s3m0_sdi = "/pinctrl/i2s3/i2s3m0-sdi";
		i2s3m0_sdo = "/pinctrl/i2s3/i2s3m0-sdo";
		lcdc_ctl = "/pinctrl/lcdc/lcdc-ctl";
		mcu_int = "/pinctrl/mcu/mcu-int";
		mcu_irq_gpio = "/pinctrl/mcu/mcu_irq_gpio";
		pdmm0_clk = "/pinctrl/pdm/pdmm0-clk";
		pdmm0_clk1 = "/pinctrl/pdm/pdmm0-clk1";
		pdmm0_sdi0 = "/pinctrl/pdm/pdmm0-sdi0";
		pdmm0_sdi1 = "/pinctrl/pdm/pdmm0-sdi1";
		pdmm0_sdi2 = "/pinctrl/pdm/pdmm0-sdi2";
		pdmm0_sdi3 = "/pinctrl/pdm/pdmm0-sdi3";
		pmic_int = "/pinctrl/pmic/pmic_int";
		soc_slppin_gpio = "/pinctrl/pmic/soc_slppin_gpio";
		soc_slppin_slp = "/pinctrl/pmic/soc_slppin_slp";
		soc_slppin_rst = "/pinctrl/pmic/soc_slppin_rst";
		pwm0m0_pins = "/pinctrl/pwm0/pwm0m0-pins";
		pwm1m0_pins = "/pinctrl/pwm1/pwm1m0-pins";
		pwm2m0_pins = "/pinctrl/pwm2/pwm2m0-pins";
		pwm3_pins = "/pinctrl/pwm3/pwm3-pins";
		pwm4_pins = "/pinctrl/pwm4/pwm4-pins";
		pwm5_pins = "/pinctrl/pwm5/pwm5-pins";
		pwm6_pins = "/pinctrl/pwm6/pwm6-pins";
		pwm7_pins = "/pinctrl/pwm7/pwm7-pins";
		pwm8m0_pins = "/pinctrl/pwm8/pwm8m0-pins";
		pwm9m0_pins = "/pinctrl/pwm9/pwm9m0-pins";
		pwm10m0_pins = "/pinctrl/pwm10/pwm10m0-pins";
		pwm11m0_pins = "/pinctrl/pwm11/pwm11m0-pins";
		pwm12m0_pins = "/pinctrl/pwm12/pwm12m0-pins";
		pwm13m0_pins = "/pinctrl/pwm13/pwm13m0-pins";
		pwm14m0_pins = "/pinctrl/pwm14/pwm14m0-pins";
		pwm15m0_pins = "/pinctrl/pwm15/pwm15m0-pins";
		scr_pins = "/pinctrl/scr/scr-pins";
		sdmmc0_bus4 = "/pinctrl/sdmmc0/sdmmc0-bus4";
		sdmmc0_clk = "/pinctrl/sdmmc0/sdmmc0-clk";
		sdmmc0_cmd = "/pinctrl/sdmmc0/sdmmc0-cmd";
		sdmmc0_det = "/pinctrl/sdmmc0/sdmmc0-det";
		sdmmc1_bus4 = "/pinctrl/sdmmc1/sdmmc1-bus4";
		sdmmc1_clk = "/pinctrl/sdmmc1/sdmmc1-clk";
		sdmmc1_cmd = "/pinctrl/sdmmc1/sdmmc1-cmd";
		sdmmc2m0_bus4 = "/pinctrl/sdmmc2/sdmmc2m0-bus4";
		sdmmc2m0_clk = "/pinctrl/sdmmc2/sdmmc2m0-clk";
		sdmmc2m0_cmd = "/pinctrl/sdmmc2/sdmmc2m0-cmd";
		spdifm1_tx = "/pinctrl/spdif/spdifm1-tx";
		spi0m0_pins = "/pinctrl/spi0/spi0m0-pins";
		spi0m0_cs0 = "/pinctrl/spi0/spi0m0-cs0";
		spi0m0_cs1 = "/pinctrl/spi0/spi0m0-cs1";
		spi1m0_pins = "/pinctrl/spi1/spi1m0-pins";
		spi1m0_cs0 = "/pinctrl/spi1/spi1m0-cs0";
		spi1m0_cs1 = "/pinctrl/spi1/spi1m0-cs1";
		spi2m0_pins = "/pinctrl/spi2/spi2m0-pins";
		spi2m0_cs0 = "/pinctrl/spi2/spi2m0-cs0";
		spi2m0_cs1 = "/pinctrl/spi2/spi2m0-cs1";
		spi3m1_pins = "/pinctrl/spi3/spi3m1-pins";
		spi3m1_cs0 = "/pinctrl/spi3/spi3m1-cs0";
		spi3m1_cs1 = "/pinctrl/spi3/spi3m1-cs1";
		tsadc_shutorg = "/pinctrl/tsadc/tsadc-shutorg";
		uart0_xfer = "/pinctrl/uart0/uart0-xfer";
		uart1m0_xfer = "/pinctrl/uart1/uart1m0-xfer";
		uart1m0_ctsn = "/pinctrl/uart1/uart1m0-ctsn";
		uart1m0_rtsn = "/pinctrl/uart1/uart1m0-rtsn";
		uart2m0_xfer = "/pinctrl/uart2/uart2m0-xfer";
		uart3m1_xfer = "/pinctrl/uart3/uart3m1-xfer";
		uart4m1_xfer = "/pinctrl/uart4/uart4m1-xfer";
		uart5m0_xfer = "/pinctrl/uart5/uart5m0-xfer";
		uart6m0_xfer = "/pinctrl/uart6/uart6m0-xfer";
		uart7m1_xfer = "/pinctrl/uart7/uart7m1-xfer";
		uart8m1_xfer = "/pinctrl/uart8/uart8m1-xfer";
		uart9m1_xfer = "/pinctrl/uart9/uart9m1-xfer";
		spi0m0_pins_hs = "/pinctrl/spi0-hs/spi0m0-pins";
		spi1m0_pins_hs = "/pinctrl/spi1-hs/spi1m0-pins";
		spi2m0_pins_hs = "/pinctrl/spi2-hs/spi2m0-pins";
		spi3m1_pins_hs = "/pinctrl/spi3-hs/spi3m1-pins";
		tsadc_gpio_func = "/pinctrl/gpio-func/tsadc-gpio-func";
		mxc6655xa_irq_gpio = "/pinctrl/mxc6655xa/mxc6655xa_irq_gpio";
		touch_gpio = "/pinctrl/touch/touch-gpio";
		wifi_enable_h = "/pinctrl/sdio-pwrseq/wifi-enable-h";
		uart8_gpios = "/pinctrl/wireless-bluetooth/uart8-gpios";
		bt_gpios = "/pinctrl/wireless-bluetooth/bt-gpios";
		backlight_en = "/pinctrl/backlight/backlight-en";
		backlight_en1 = "/pinctrl/backlight1/backlight-en1";
		edp_panel_enable = "/pinctrl/edp_panel/edp-panel-enable";
		hp_det = "/pinctrl/headphone/hp-det";
		wifi_host_wake_irq = "/pinctrl/wireless-wlan/wifi-host-wake-irq";
		smdtio = "/smdtio";
		smdt_param = "/smdt_param";
		smdt_os_param = "/smdt_os_param";
		adc_keys = "/adc-keys";
		audiopwmout_diff = "/audiopwmout-diff";
		master = "/audiopwmout-diff/simple-audio-card,codec";
		backlight = "/backlight";
		backlight1 = "/backlight1";
		dc_12v = "/dc-12v";
		rk809_sound = "/rk809-sound";
		hdmi_sound = "/hdmi-sound";
		leds = "/leds";
		work_led = "/leds/work";
		pdmics = "/dummy-codec";
		pdm_mic_array = "/pdm-mic-array";
		spdif_out = "/spdif-out";
		vad_sound = "/vad-sound";
		vcc3v3_sys = "/vcc3v3-sys";
		vcc5v0_sys = "/vcc5v0-sys";
		vcc5v0_usb = "/vcc5v0-usb";
		vcc5v0_host = "/vcc5v0-host-regulator";
		vcc5v0_otg = "/vcc5v0-otg-regulator";
		vcc3v3_lcd0_n = "/vcc3v3-lcd0-n";
		vcc3v3_lcd1_n = "/vcc3v3-lcd1-n";
		sdio_pwrseq = "/sdio-pwrseq";
		wireless_wlan = "/wireless-wlan";
		wireless_bluetooth = "/wireless-bluetooth";
		edp_panel = "/edp_panel";
		edp_timing = "/edp_panel/display-timings/edp_timing";
		panel_in = "/edp_panel/ports/endpoint";
		lvds_panel = "/lvds_panel";
		lvds_timing = "/lvds_panel/display-timings/lvds_timing";
		panel_in_lvds = "/lvds_panel/ports/port@0/endpoint";
		rk_headset = "/rk-headset";
		vcc2v5_sys = "/vcc2v5-ddr";
		vcc3v3_vga = "/vcc3v3-vga";
		pcie30_avdd0v9 = "/pcie30-avdd0v9";
		pcie30_avdd1v8 = "/pcie30-avdd1v8";
		vcc3v3_pcie = "/gpio-regulator";
		vcc3v3_bu = "/vcc3v3-bu";
		chosen = "/chosen";
		debug = "/debug@fd904000";
		cspmu = "/cspmu@fd90c000";
		shimetaos_property = "/shimetaos_property";
	};
};

&ddr3_params { phandle = <0xb1>; };
&ddr4_params { phandle = <0xb2>; };
&lpddr3_params { phandle = <0xb3>; };
&lpddr4_params { phandle = <0xb4>; };
&lpddr4x_params { phandle = <0xb5>; };
&cpu0 { phandle = <0x9>; };
&cpu1 { phandle = <0xa>; };
&cpu2 { phandle = <0xb>; };
&cpu3 { phandle = <0xc>; };
&CPU_SLEEP { phandle = <0x4>; };
&cpu0_opp_table { phandle = <0x3>; };
&display_subsystem { phandle = <0x156>; };
&route_dsi0 { phandle = <0x157>; };
&route_dsi1 { phandle = <0x158>; };
&route_edp { phandle = <0x159>; };
&route_hdmi { phandle = <0x15a>; };
&route_lvds { phandle = <0x15b>; };
&route_rgb { phandle = <0x15c>; };
&firmware_android { phandle = <0x15d>; };
&optee { phandle = <0x15e>; };
&scmi { phandle = <0x15f>; };
&scmi_clk { phandle = <0x2>; };
&sdei { phandle = <0x160>; };
&mpp_srv { phandle = <0x6e>; };
&reserved_memory { phandle = <0x161>; };
&drm_logo { phandle = <0x10>; };
&drm_cubic_lut { phandle = <0x11>; };
&isp_reserved { phandle = <0x162>; };
&cif_reserved { phandle = <0x79>; };
&reserved { phandle = <0x163>; };
&ramoops { phandle = <0x164>; };
&rockchip_suspend { phandle = <0x165>; };
&rockchip_system_monitor { phandle = <0x166>; };
&thermal_zones { phandle = <0x167>; };
&soc_thermal { phandle = <0x168>; };
&threshold { phandle = <0x169>; };
&target { phandle = <0x1c>; };
&soc_crit { phandle = <0x16a>; };
&gpu_thermal { phandle = <0x16b>; };
&gmac0_clkin { phandle = <0x16c>; };
&gmac1_clkin { phandle = <0x16d>; };
&gmac0_xpcsclk { phandle = <0x16e>; };
&gmac1_xpcsclk { phandle = <0x16f>; };
&i2s1_mclkin_rx { phandle = <0x170>; };
&i2s1_mclkin_tx { phandle = <0x171>; };
&i2s2_mclkin { phandle = <0x172>; };
&i2s3_mclkin { phandle = <0x173>; };
&mpll { phandle = <0x174>; };
&xin24m { phandle = <0x175>; };
&xin32k { phandle = <0x176>; };
&scmi_shmem { phandle = <0x1a>; };
&sata0 { phandle = <0x177>; };
&sata1 { phandle = <0x178>; };
&sata2 { phandle = <0x179>; };
&usbdrd30 { phandle = <0x17a>; };
&usbdrd_dwc3 { phandle = <0x17b>; };
&usbhost30 { phandle = <0x17c>; };
&usbhost_dwc3 { phandle = <0x17d>; };
&gic { phandle = <0x1>; };
&its { phandle = <0xb7>; };
&usb_host0_ehci { phandle = <0x17e>; };
&usb_host0_ohci { phandle = <0x17f>; };
&usb_host1_ehci { phandle = <0x180>; };
&usb_host1_ohci { phandle = <0x181>; };
&xpcs { phandle = <0x182>; };
&pmugrf { phandle = <0x34>; };
&pmu_io_domains { phandle = <0x183>; };
&reboot_mode { phandle = <0x184>; };
&pipegrf { phandle = <0x120>; };
&grf { phandle = <0x33>; };
&io_domains { phandle = <0x185>; };
&lvds { phandle = <0x186>; };
&lvds_in_vp1 { phandle = <0x93>; };
&lvds_in_vp2 { phandle = <0x94>; };
&lvds_out_panel { phandle = <0x154>; };
&rgb { phandle = <0x187>; };
&rgb_in_vp2 { phandle = <0x95>; };
&pipe_phy_grf0 { phandle = <0x121>; };
&pipe_phy_grf1 { phandle = <0x122>; };
&pipe_phy_grf2 { phandle = <0x123>; };
&usb2phy0_grf { phandle = <0x12b>; };
&usb2phy1_grf { phandle = <0x12e>; };
&edp_phy_grf { phandle = <0x188>; };
&edp_phy { phandle = <0xa7>; };
&pcie30_phy_grf { phandle = <0x12f>; };
&sram { phandle = <0x189>; };
&rkvdec_sram { phandle = <0x77>; };
&pmucru { phandle = <0x32>; };
&cru { phandle = <0x1f>; };
&i2c0 { phandle = <0x18a>; };
&vdd_cpu { phandle = <0x5>; };
&rk809 { phandle = <0x14b>; };
&pinctrl_rk8xx { phandle = <0x18b>; };
&rk817_slppin_null { phandle = <0x18c>; };
&rk817_slppin_slp { phandle = <0x3a>; };
&rk817_slppin_pwrdn { phandle = <0x3c>; };
&rk817_slppin_rst { phandle = <0x3d>; };
&vdd_logic { phandle = <0x69>; };
&vdd_gpu { phandle = <0x6b>; };
&vcc_ddr { phandle = <0x18d>; };
&vdd_npu { phandle = <0x66>; };
&vdda0v9_image { phandle = <0x18e>; };
&vdda_0v9 { phandle = <0x18f>; };
&vdda0v9_pmu { phandle = <0x190>; };
&vccio_acodec { phandle = <0x2a>; };
&vccio_sd { phandle = <0x2b>; };
&vcc3v3_pmu { phandle = <0x29>; };
&vcca_1v8 { phandle = <0x11f>; };
&vcca1v8_pmu { phandle = <0x191>; };
&vcca1v8_image { phandle = <0x192>; };
&vcc_1v8 { phandle = <0x2c>; };
&vcc_3v3 { phandle = <0x2d>; };
&vcc3v3_sd { phandle = <0xc6>; };
&rk809_codec { phandle = <0x141>; };
&bq25700 { phandle = <0x42>; };
&fusb0 { phandle = <0x41>; };
&uart0 { phandle = <0x193>; };
&pwm0 { phandle = <0x194>; };
&pwm1 { phandle = <0x195>; };
&pwm2 { phandle = <0x196>; };
&pwm3 { phandle = <0x197>; };
&pmu { phandle = <0x198>; };
&power { phandle = <0x21>; };
&rknpu { phandle = <0x199>; };
&npu_opp_table { phandle = <0x64>; };
&bus_npu { phandle = <0x19a>; };
&bus_npu_opp_table { phandle = <0x68>; };
&rknpu_mmu { phandle = <0x65>; };
&gpu { phandle = <0x1d>; };
&gpu_power_model { phandle = <0x19b>; };
&gpu_opp_table { phandle = <0x6a>; };
&vdpu { phandle = <0x19c>; };
&vdpu_mmu { phandle = <0x6d>; };
&rk_rga { phandle = <0x19d>; };
&ebc { phandle = <0x19e>; };
&jpegd { phandle = <0x19f>; };
&jpegd_mmu { phandle = <0x70>; };
&vepu { phandle = <0x1a0>; };
&vepu_mmu { phandle = <0x71>; };
&iep { phandle = <0x1a1>; };
&iep_mmu { phandle = <0x72>; };
&eink { phandle = <0x1a2>; };
&rkvenc { phandle = <0x1a3>; };
&rkvenc_opp_table { phandle = <0x74>; };
&rkvenc_mmu { phandle = <0x73>; };
&rkvdec { phandle = <0x1a4>; };
&rkvdec_opp_table { phandle = <0x75>; };
&rkvdec_mmu { phandle = <0x76>; };
&mipi_csi2 { phandle = <0x1a5>; };
&rkcif { phandle = <0x7a>; };
&rkcif_mmu { phandle = <0x1a6>; };
&rkcif_dvp { phandle = <0x7b>; };
&rkcif_dvp_sditf { phandle = <0x1a7>; };
&rkcif_mipi_lvds { phandle = <0x7c>; };
&rkcif_mipi_lvds_sditf { phandle = <0x1a8>; };
&rkisp { phandle = <0x7e>; };
&rkisp_mmu { phandle = <0x7d>; };
&rkisp_vir0 { phandle = <0x1a9>; };
&isp0_in { phandle = <0x129>; };
&rkisp_vir1 { phandle = <0x1aa>; };
&gmac1 { phandle = <0x1ab>; };
&mdio1 { phandle = <0x1ac>; };
&rgmii_phy1 { phandle = <0x89>; };
&gmac1_stmmac_axi_setup { phandle = <0x80>; };
&gmac1_mtl_rx_setup { phandle = <0x81>; };
&gmac1_mtl_tx_setup { phandle = <0x82>; };
&vop { phandle = <0x1ad>; };
&vop_out { phandle = <0x12>; };
&vp0 { phandle = <0x1ae>; };
&vp0_out_dsi0 { phandle = <0x96>; };
&vp0_out_dsi1 { phandle = <0x15>; };
&vp0_out_edp { phandle = <0x16>; };
&vp0_out_hdmi { phandle = <0x17>; };
&vp1 { phandle = <0x1af>; };
&vp1_out_dsi0 { phandle = <0x14>; };
&vp1_out_dsi1 { phandle = <0x9d>; };
&vp1_out_edp { phandle = <0xa8>; };
&vp1_out_hdmi { phandle = <0xa6>; };
&vp1_out_lvds { phandle = <0x18>; };
&vp2 { phandle = <0x1b0>; };
&vp2_out_lvds { phandle = <0x2f>; };
&vp2_out_rgb { phandle = <0x19>; };
&vop_mmu { phandle = <0x8a>; };
&dsi0 { phandle = <0x1b1>; };
&dsi0_in { phandle = <0x1b2>; };
&dsi0_in_vp0 { phandle = <0x8b>; };
&dsi0_in_vp1 { phandle = <0x8f>; };
&dsi_out_panel { phandle = <0x9b>; };
&dsi0_panel { phandle = <0x1b3>; };
&dsi0_timing { phandle = <0x9a>; };
&dsi0_timing_default { phandle = <0x1b4>; };
&panel_in_dsi { phandle = <0x97>; };
&dsi1 { phandle = <0x1b5>; };
&dsi1_in { phandle = <0x1b6>; };
&dsi1_in_vp0 { phandle = <0x8c>; };
&dsi1_in_vp1 { phandle = <0x90>; };
&dsi1_out_panel { phandle = <0xa2>; };
&dsi1_panel { phandle = <0x1b7>; };
&dsi1_timing { phandle = <0xa1>; };
&dsi1_timing_default { phandle = <0x1b8>; };
&panel_in_dsi1 { phandle = <0x9e>; };
&hdmi { phandle = <0x143>; };
&hdmi_in { phandle = <0x1b9>; };
&hdmi_in_vp0 { phandle = <0x8e>; };
&hdmi_in_vp1 { phandle = <0x92>; };
&edp { phandle = <0x1ba>; };
&edp_in { phandle = <0x1bb>; };
&edp_in_vp0 { phandle = <0x8d>; };
&edp_in_vp1 { phandle = <0x91>; };
&edp_out { phandle = <0x152>; };
&nocp_cpu { phandle = <0xaf>; };
&nocp_gpu_vpu_rga_venc { phandle = <0x1bc>; };
&nocp_npu_vdec { phandle = <0x1bd>; };
&nocp_vi_usb_peri_pipe { phandle = <0x1be>; };
&nocp_vo { phandle = <0x1bf>; };
&qos_gpu { phandle = <0x4a>; };
&qos_rkvenc_rd_m0 { phandle = <0x59>; };
&qos_rkvenc_rd_m1 { phandle = <0x5a>; };
&qos_rkvenc_wr_m0 { phandle = <0x5b>; };
&qos_isp { phandle = <0x4b>; };
&qos_vicap0 { phandle = <0x4c>; };
&qos_vicap1 { phandle = <0x4d>; };
&qos_vpu { phandle = <0x57>; };
&qos_ebc { phandle = <0x51>; };
&qos_iep { phandle = <0x52>; };
&qos_jpeg_dec { phandle = <0x53>; };
&qos_jpeg_enc { phandle = <0x54>; };
&qos_rga_rd { phandle = <0x55>; };
&qos_rga_wr { phandle = <0x56>; };
&qos_npu { phandle = <0x49>; };
&qos_pcie2x1 { phandle = <0x5c>; };
&qos_pcie3x1 { phandle = <0x5d>; };
&qos_pcie3x2 { phandle = <0x5e>; };
&qos_sata0 { phandle = <0x5f>; };
&qos_sata1 { phandle = <0x60>; };
&qos_sata2 { phandle = <0x61>; };
&qos_usb3_0 { phandle = <0x62>; };
&qos_usb3_1 { phandle = <0x63>; };
&qos_rkvdec { phandle = <0x58>; };
&qos_hdcp { phandle = <0x4e>; };
&qos_vop_m0 { phandle = <0x4f>; };
&qos_vop_m1 { phandle = <0x50>; };
&sdmmc2 { phandle = <0x1c0>; };
&dfi { phandle = <0xae>; };
&dmc { phandle = <0x13>; };
&dmc_fsp { phandle = <0x1c1>; };
&dmc_opp_table { phandle = <0xb0>; };
&dmcdbg { phandle = <0x1c2>; };
&pcie2x1 { phandle = <0x1c3>; };
&pcie2x1_intc { phandle = <0xb6>; };
&pcie3x1 { phandle = <0x1c4>; };
&pcie3x1_intc { phandle = <0xb8>; };
&pcie3x2 { phandle = <0x1c5>; };
&pcie3x2_intc { phandle = <0xba>; };
&gmac0 { phandle = <0x1c6>; };
&mdio0 { phandle = <0x1c7>; };
&rgmii_phy0 { phandle = <0xc5>; };
&gmac0_stmmac_axi_setup { phandle = <0xbd>; };
&gmac0_mtl_rx_setup { phandle = <0xbe>; };
&gmac0_mtl_tx_setup { phandle = <0xbf>; };
&sdmmc0 { phandle = <0x1c8>; };
&sdmmc1 { phandle = <0x1c9>; };
&sfc { phandle = <0x1ca>; };
&sdhci { phandle = <0x1cb>; };
&nandc0 { phandle = <0x1cc>; };
&crypto { phandle = <0x1cd>; };
&rng { phandle = <0x1ce>; };
&otp { phandle = <0x1cf>; };
&cpu_code { phandle = <0xf>; };
&otp_cpu_version { phandle = <0xe>; };
&mbist_vmin { phandle = <0x8>; };
&otp_id { phandle = <0xd>; };
&cpu_leakage { phandle = <0x6>; };
&log_leakage { phandle = <0x78>; };
&npu_leakage { phandle = <0x67>; };
&gpu_leakage { phandle = <0x6c>; };
&core_pvtm { phandle = <0x7>; };
&i2s0_8ch { phandle = <0x142>; };
&i2s1_8ch { phandle = <0xe1>; };
&i2s2_2ch { phandle = <0x1d0>; };
&i2s3_2ch { phandle = <0x13c>; };
&pdm { phandle = <0x144>; };
&vad { phandle = <0x148>; };
&spdif_8ch { phandle = <0x146>; };
&audpwm { phandle = <0x1d1>; };
&dig_acodec { phandle = <0x13d>; };
&dmac0 { phandle = <0x43>; };
&dmac1 { phandle = <0xce>; };
&scr { phandle = <0x1d2>; };
&can0 { phandle = <0x1d3>; };
&can1 { phandle = <0x1d4>; };
&can2 { phandle = <0x1d5>; };
&i2c1 { phandle = <0x1d6>; };
&gt1x { phandle = <0x1d7>; };
&xrm { phandle = <0x1d8>; };
&i2c2 { phandle = <0x1d9>; };
&ov13850 { phandle = <0x1da>; };
&ov13850_out { phandle = <0x128>; };
&vm149c { phandle = <0xee>; };
&ov5695 { phandle = <0x1db>; };
&ov5695_out { phandle = <0x127>; };
&i2c3 { phandle = <0x1dc>; };
&i2c4 { phandle = <0x1dd>; };
&gc8034 { phandle = <0x1de>; };
&gc8034_out { phandle = <0x126>; };
&os04a10 { phandle = <0x1df>; };
&ucam_out0 { phandle = <0x125>; };
&i2c5 { phandle = <0x1e0>; };
&mxc6655xa { phandle = <0x1e1>; };
&mcu { phandle = <0x1e2>; };
&at24c16 { phandle = <0x1e3>; };
&rktimer { phandle = <0x1e4>; };
&wdt { phandle = <0x1e5>; };
&spi0 { phandle = <0x1e6>; };
&spi1 { phandle = <0x1e7>; };
&spi2 { phandle = <0x1e8>; };
&spi3 { phandle = <0x1e9>; };
&uart1 { phandle = <0x1ea>; };
&uart2 { phandle = <0x1eb>; };
&uart3 { phandle = <0x1ec>; };
&uart4 { phandle = <0x1ed>; };
&uart5 { phandle = <0x1ee>; };
&uart6 { phandle = <0x1ef>; };
&uart7 { phandle = <0x1f0>; };
&uart8 { phandle = <0x1f1>; };
&uart9 { phandle = <0x1f2>; };
&pwm4 { phandle = <0x13e>; };
&pwm5 { phandle = <0x13f>; };
&pwm6 { phandle = <0x1f3>; };
&pwm7 { phandle = <0x1f4>; };
&pwm8 { phandle = <0x1f5>; };
&pwm9 { phandle = <0x1f6>; };
&pwm10 { phandle = <0x1f7>; };
&pwm11 { phandle = <0x1f8>; };
&pwm12 { phandle = <0x1f9>; };
&pwm13 { phandle = <0x1fa>; };
&pwm14 { phandle = <0x1fb>; };
&pwm15 { phandle = <0x1fc>; };
&tsadc { phandle = <0x1b>; };
&saradc { phandle = <0x13a>; };
&mailbox { phandle = <0x1fd>; };
&combphy0_us { phandle = <0x20>; };
&combphy1_usq { phandle = <0x22>; };
&combphy2_psq { phandle = <0x23>; };
&video_phy0 { phandle = <0x2e>; };
&video_phy1 { phandle = <0x9c>; };
&csi2_dphy_hw { phandle = <0x124>; };
&csi2_dphy0 { phandle = <0x1fe>; };
&mipi_in_ucam0 { phandle = <0xf3>; };
&mipi_in_ucam1 { phandle = <0xf2>; };
&mipi_in_ucam2 { phandle = <0xef>; };
&mipi_in_ucam3 { phandle = <0xed>; };
&csidphy_out { phandle = <0x7f>; };
&csi2_dphy1 { phandle = <0x1ff>; };
&csi2_dphy2 { phandle = <0x200>; };
&usb2phy0 { phandle = <0x12a>; };
&u2phy0_host { phandle = <0x25>; };
&u2phy0_otg { phandle = <0x24>; };
&usb2phy1 { phandle = <0x26>; };
&u2phy1_host { phandle = <0x28>; };
&u2phy1_otg { phandle = <0x27>; };
&pcie30phy { phandle = <0xb9>; };
&pinctrl { phandle = <0x130>; };
&gpio0 { phandle = <0x37>; };
&gpio1 { phandle = <0xea>; };
&gpio2 { phandle = <0xbb>; };
&gpio3 { phandle = <0x83>; };
&gpio4 { phandle = <0x40>; };
&pcfg_pull_up { phandle = <0x133>; };
&pcfg_pull_none { phandle = <0x131>; };
&pcfg_pull_none_drv_level_1 { phandle = <0x135>; };
&pcfg_pull_none_drv_level_2 { phandle = <0x134>; };
&pcfg_pull_none_drv_level_3 { phandle = <0x139>; };
&pcfg_pull_up_drv_level_1 { phandle = <0x138>; };
&pcfg_pull_up_drv_level_2 { phandle = <0x132>; };
&pcfg_pull_none_smt { phandle = <0x136>; };
&pcfg_output_low_pull_down { phandle = <0x137>; };
&acodec_pins { phandle = <0xe3>; };
&camera_pwr { phandle = <0x201>; };
&can0m1_pins { phandle = <0xe5>; };
&can1m1_pins { phandle = <0xe6>; };
&can2m1_pins { phandle = <0xe7>; };
&cif_clk { phandle = <0xec>; };
&clk32k_out0 { phandle = <0x1e>; };
&ebc_pins { phandle = <0x6f>; };
&gmac0_miim { phandle = <0xc0>; };
&gmac0_rx_bus2 { phandle = <0xc2>; };
&gmac0_tx_bus2 { phandle = <0xc1>; };
&gmac0_rgmii_clk { phandle = <0xc3>; };
&gmac0_rgmii_bus { phandle = <0xc4>; };
&gmac1m1_miim { phandle = <0x84>; };
&gmac1m1_rx_bus2 { phandle = <0x86>; };
&gmac1m1_tx_bus2 { phandle = <0x85>; };
&gmac1m1_rgmii_clk { phandle = <0x87>; };
&gmac1m1_rgmii_bus { phandle = <0x88>; };
&hdmitxm0_cec { phandle = <0xa5>; };
&hdmitx_scl { phandle = <0xa3>; };
&hdmitx_sda { phandle = <0xa4>; };
&i2c0_xfer { phandle = <0x35>; };
&i2c1_xfer { phandle = <0xe8>; };
&i2c2m1_xfer { phandle = <0xeb>; };
&i2c3m0_xfer { phandle = <0xf0>; };
&i2c4m0_xfer { phandle = <0xf1>; };
&i2c5m0_xfer { phandle = <0xf4>; };
&i2s1m0_lrcktx { phandle = <0xd0>; };
&i2s1m0_mclk { phandle = <0x3f>; };
&i2s1m0_sclktx { phandle = <0xcf>; };
&i2s1m0_sdi0 { phandle = <0xd1>; };
&i2s1m0_sdo0 { phandle = <0xd2>; };
&i2s2m0_lrcktx { phandle = <0xd4>; };
&i2s2m0_sclktx { phandle = <0xd3>; };
&i2s2m0_sdi { phandle = <0xd5>; };
&i2s2m0_sdo { phandle = <0xd6>; };
&i2s3m0_lrck { phandle = <0xd8>; };
&i2s3m0_sclk { phandle = <0xd7>; };
&i2s3m0_sdi { phandle = <0xd9>; };
&i2s3m0_sdo { phandle = <0xda>; };
&lcdc_ctl { phandle = <0x31>; };
&mcu_int { phandle = <0x202>; };
&mcu_irq_gpio { phandle = <0xf6>; };
&pdmm0_clk { phandle = <0xdb>; };
&pdmm0_clk1 { phandle = <0xdc>; };
&pdmm0_sdi0 { phandle = <0xdd>; };
&pdmm0_sdi1 { phandle = <0xde>; };
&pdmm0_sdi2 { phandle = <0xdf>; };
&pdmm0_sdi3 { phandle = <0xe0>; };
&pmic_int { phandle = <0x38>; };
&soc_slppin_gpio { phandle = <0x3b>; };
&soc_slppin_slp { phandle = <0x39>; };
&soc_slppin_rst { phandle = <0x203>; };
&pwm0m0_pins { phandle = <0x45>; };
&pwm1m0_pins { phandle = <0x46>; };
&pwm2m0_pins { phandle = <0x47>; };
&pwm3_pins { phandle = <0x48>; };
&pwm4_pins { phandle = <0x111>; };
&pwm5_pins { phandle = <0x112>; };
&pwm6_pins { phandle = <0x113>; };
&pwm7_pins { phandle = <0x114>; };
&pwm8m0_pins { phandle = <0x115>; };
&pwm9m0_pins { phandle = <0x116>; };
&pwm10m0_pins { phandle = <0x117>; };
&pwm11m0_pins { phandle = <0x118>; };
&pwm12m0_pins { phandle = <0x119>; };
&pwm13m0_pins { phandle = <0x11a>; };
&pwm14m0_pins { phandle = <0x11b>; };
&pwm15m0_pins { phandle = <0x11c>; };
&scr_pins { phandle = <0xe4>; };
&sdmmc0_bus4 { phandle = <0xc7>; };
&sdmmc0_clk { phandle = <0xc8>; };
&sdmmc0_cmd { phandle = <0xc9>; };
&sdmmc0_det { phandle = <0xca>; };
&sdmmc1_bus4 { phandle = <0xcb>; };
&sdmmc1_clk { phandle = <0xcd>; };
&sdmmc1_cmd { phandle = <0xcc>; };
&sdmmc2m0_bus4 { phandle = <0xab>; };
&sdmmc2m0_clk { phandle = <0xad>; };
&sdmmc2m0_cmd { phandle = <0xac>; };
&spdifm1_tx { phandle = <0xe2>; };
&spi0m0_pins { phandle = <0xf9>; };
&spi0m0_cs0 { phandle = <0xf7>; };
&spi0m0_cs1 { phandle = <0xf8>; };
&spi1m0_pins { phandle = <0xfd>; };
&spi1m0_cs0 { phandle = <0xfb>; };
&spi1m0_cs1 { phandle = <0xfc>; };
&spi2m0_pins { phandle = <0x101>; };
&spi2m0_cs0 { phandle = <0xff>; };
&spi2m0_cs1 { phandle = <0x100>; };
&spi3m1_pins { phandle = <0x105>; };
&spi3m1_cs0 { phandle = <0x103>; };
&spi3m1_cs1 { phandle = <0x104>; };
&tsadc_shutorg { phandle = <0x11e>; };
&uart0_xfer { phandle = <0x44>; };
&uart1m0_xfer { phandle = <0x107>; };
&uart1m0_ctsn { phandle = <0x108>; };
&uart1m0_rtsn { phandle = <0x14e>; };
&uart2m0_xfer { phandle = <0x109>; };
&uart3m1_xfer { phandle = <0x10a>; };
&uart4m1_xfer { phandle = <0x10b>; };
&uart5m0_xfer { phandle = <0x10c>; };
&uart6m0_xfer { phandle = <0x10d>; };
&uart7m1_xfer { phandle = <0x10e>; };
&uart8m1_xfer { phandle = <0x10f>; };
&uart9m1_xfer { phandle = <0x110>; };
&spi0m0_pins_hs { phandle = <0xfa>; };
&spi1m0_pins_hs { phandle = <0xfe>; };
&spi2m0_pins_hs { phandle = <0x102>; };
&spi3m1_pins_hs { phandle = <0x106>; };
&tsadc_gpio_func { phandle = <0x11d>; };
&mxc6655xa_irq_gpio { phandle = <0xf5>; };
&touch_gpio { phandle = <0xe9>; };
&wifi_enable_h { phandle = <0x14c>; };
&uart8_gpios { phandle = <0x204>; };
&bt_gpios { phandle = <0x14f>; };
&backlight_en { phandle = <0x205>; };
&backlight_en1 { phandle = <0x140>; };
&edp_panel_enable { phandle = <0x150>; };
&hp_det { phandle = <0x155>; };
&wifi_host_wake_irq { phandle = <0x14d>; };
&smdtio { phandle = <0x206>; };
&smdt_param { phandle = <0x207>; };
&smdt_os_param { phandle = <0x208>; };
&adc_keys { phandle = <0x209>; };
&audiopwmout_diff { phandle = <0x20a>; };
&master { phandle = <0x13b>; };
&backlight { phandle = <0x98>; };
&backlight1 { phandle = <0x9f>; };
&dc_12v { phandle = <0x149>; };
&rk809_sound { phandle = <0x20b>; };
&hdmi_sound { phandle = <0x20c>; };
&leds { phandle = <0x20d>; };
&work_led { phandle = <0x20e>; };
&pdmics { phandle = <0x145>; };
&pdm_mic_array { phandle = <0x20f>; };
&spdif_out { phandle = <0x147>; };
&vad_sound { phandle = <0x210>; };
&vcc3v3_sys { phandle = <0x3e>; };
&vcc5v0_sys { phandle = <0x36>; };
&vcc5v0_usb { phandle = <0x14a>; };
&vcc5v0_host { phandle = <0x12c>; };
&vcc5v0_otg { phandle = <0x12d>; };
&vcc3v3_lcd0_n { phandle = <0x99>; };
&vcc3v3_lcd1_n { phandle = <0xa0>; };
&sdio_pwrseq { phandle = <0xaa>; };
&wireless_wlan { phandle = <0x211>; };
&wireless_bluetooth { phandle = <0x212>; };
&edp_panel { phandle = <0x213>; };
&edp_timing { phandle = <0x151>; };
&panel_in { phandle = <0xa9>; };
&lvds_panel { phandle = <0x214>; };
&lvds_timing { phandle = <0x153>; };
&panel_in_lvds { phandle = <0x30>; };
&rk_headset { phandle = <0x215>; };
&vcc2v5_sys { phandle = <0x216>; };
&vcc3v3_vga { phandle = <0x217>; };
&pcie30_avdd0v9 { phandle = <0x218>; };
&pcie30_avdd1v8 { phandle = <0x219>; };
&vcc3v3_pcie { phandle = <0xbc>; };
&vcc3v3_bu { phandle = <0x21a>; };
&chosen { phandle = <0x21b>; };
&debug { phandle = <0x21c>; };
&cspmu { phandle = <0x21d>; };
&shimetaos_property { phandle = <0x21e>; };
